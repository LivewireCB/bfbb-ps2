SECTIONS
{
    __romPos = 0;
    _gp = cod_SBSS_START + 0x7FF0;
    cod_ROM_START = __romPos;
    cod_VRAM = ADDR(.cod);
    .cod 0x100000 : AT(cod_ROM_START)
    {
        FILL(0x00000000);
        cod_TEXT_START = .;
        build/asm/cod/000000.o(.text*);
        build/src/SB/Game/zAnimList.o(.text*);
        build/src/SB/Game/zAssetTypes.o(.text*);
        build/src/SB/Game/zCamera.o(.text*);
        build/src/SB/Game/zConditional.o(.text*);
        build/src/SB/Game/zCutsceneMgr.o(.text*);
        build/src/SB/Game/zDispatcher.o(.text*);
        build/src/SB/Game/zEGenerator.o(.text*);
        build/src/SB/Game/zEnt.o(.text*);
        build/src/SB/Game/zEntButton.o(.text*);
        build/src/SB/Game/zEntDestructObj.o(.text*);
        build/src/SB/Game/zEntHangable.o(.text*);
        build/src/SB/Game/zEntPickup.o(.text*);
        build/src/SB/Game/zEntPlayer.o(.text*);
        build/src/SB/Game/zEntSimpleObj.o(.text*);
        build/src/SB/Game/zEntTrigger.o(.text*);
        build/src/SB/Game/zEnv.o(.text*);
        build/src/SB/Game/zEvent.o(.text*);
        build/src/SB/Game/zFeet.o(.text*);
        build/src/SB/Game/zFMV.o(.text*);
        build/src/SB/Game/zFX.o(.text*);
        build/src/SB/Game/zGame.o(.text*);
        build/src/SB/Game/zGameExtras.o(.text*);
        build/src/SB/Game/zGameState.o(.text*);
        build/src/SB/Game/zGust.o(.text*);
        build/src/SB/Game/zHud.o(.text*);
        build/src/SB/Game/zLight.o(.text*);
        build/src/SB/Game/zLightEffect.o(.text*);
        build/src/SB/Game/zLightning.o(.text*);
        build/src/SB/Game/zLOD.o(.text*);
        build/src/SB/Game/zMain.o(.text*);
        build/src/SB/Game/zMenu.o(.text*);
        build/src/SB/Game/zMovePoint.o(.text*);
        build/src/SB/Game/zMusic.o(.text*);
        build/src/SB/Game/zParCmd.o(.text*);
        build/src/SB/Game/zParEmitter.o(.text*);
        build/src/SB/Game/zPendulum.o(.text*);
        build/src/SB/Game/zPlatform.o(.text*);
        build/src/SB/Game/zPortal.o(.text*);
        build/src/SB/Game/zRenderState.o(.text*);
        build/src/SB/Game/zRumble.o(.text*);
        build/src/SB/Game/zSaveLoad.o(.text*);
        build/src/SB/Game/zScene.o(.text*);
        build/src/SB/Game/zScript.o(.text*);
        build/src/SB/Game/zSurface.o(.text*);
        build/src/SB/Game/zUI.o(.text*);
        build/src/SB/Game/zUIFont.o(.text*);
        build/src/SB/Game/zVar.o(.text*);
        build/src/SB/Game/zVolume.o(.text*);
        build/src/SB/Game/zActionLine.o(.text*);
        build/src/SB/Core/p2/iAnimSKB.o(.text*);
        build/src/SB/Core/p2/iCollide.o(.text*);
        build/src/SB/Core/p2/iCollideFast.o(.text*);
        build/src/SB/Core/p2/iDraw.o(.text*);
        build/src/SB/Core/p2/iEnv.o(.text*);
        build/src/SB/Core/p2/iFile.o(.text*);
        build/src/SB/Core/p2/iFMV.o(.text*);
        build/src/SB/Core/p2/iFX.o(.text*);
        build/src/SB/Core/p2/iLight.o(.text*);
        build/src/SB/Core/p2/iMath3.o(.text*);
        build/src/SB/Core/p2/iMemMgr.o(.text*);
        build/src/SB/Core/p2/iModel.o(.text*);
        build/src/SB/Core/p2/iMorph.o(.text*);
        build/src/SB/Core/p2/iPad.o(.text*);
        build/src/SB/Core/p2/iParMgr.o(.text*);
        build/src/SB/Core/p2/isavegame.o(.text*);
        build/src/SB/Core/p2/iScrFX.o(.text*);
        build/src/SB/Core/p2/iSnd.o(.text*);
        build/src/SB/Core/p2/iSystem.o(.text*);
        build/src/SB/Core/p2/iTime.o(.text*);
        build/src/SB/Core/p2/p2im3dhack.o(.text*);
        build/src/SB/Core/p2/iAnim.o(.text*);
        build/src/SB/Core/p2/ps2_mpeg/audiodec.o(.text*);
        build/src/SB/Core/p2/ps2_mpeg/disp.o(.text*);
        build/src/SB/Core/p2/ps2_mpeg/ps2_mpeg.o(.text*);
        build/src/SB/Core/p2/ps2_mpeg/read.o(.text*);
        build/src/SB/Core/p2/ps2_mpeg/readbuf.o(.text*);
        build/src/SB/Core/p2/ps2_mpeg/strfile.o(.text*);
        build/src/SB/Core/p2/ps2_mpeg/vibuf.o(.text*);
        build/src/SB/Core/p2/ps2_mpeg/videodec.o(.text*);
        build/src/SB/Core/p2/ps2_mpeg/vobuf.o(.text*);
        build/src/SB/Core/x/xBase.o(.text*);
        build/src/SB/Core/x/xbinio.o(.text*);
        build/src/SB/Core/x/xBound.o(.text*);
        build/src/SB/Core/x/xCamera.o(.text*);
        build/src/SB/Core/x/xClimate.o(.text*);
        build/src/SB/Core/x/xCollide.o(.text*);
        build/src/SB/Core/x/xCollideFast.o(.text*);
        build/src/SB/Core/x/xCutscene.o(.text*);
        build/src/SB/Core/x/xDebug.o(.text*);
        build/src/SB/Core/x/xEnt.o(.text*);
        build/src/SB/Core/x/xEntDrive.o(.text*);
        build/src/SB/Core/x/xEntMotion.o(.text*);
        build/src/SB/Core/x/xEnv.o(.text*);
        build/src/SB/Core/x/xFFX.o(.text*);
        build/src/SB/Core/x/xFont.o(.text*);
        build/src/SB/Core/x/xFX.o(.text*);
        build/src/SB/Core/x/xhipio.o(.text*);
        build/src/SB/Core/x/xIni.o(.text*);
        build/src/SB/Core/x/xMath.o(.text*);
        build/src/SB/Core/x/xMath3.o(.text*);
        build/src/SB/Core/x/xMemMgr.o(.text*);
        build/src/SB/Core/x/xModel.o(.text*);
        build/src/SB/Core/x/xMorph.o(.text*);
        build/src/SB/Core/x/xMovePoint.o(.text*);
        build/src/SB/Core/x/xordarray.o(.text*);
        build/src/SB/Core/x/xPad.o(.text*);
        build/src/SB/Core/x/xPar.o(.text*);
        build/src/SB/Core/x/xParCmd.o(.text*);
        build/src/SB/Core/x/xParGroup.o(.text*);
        build/src/SB/Core/x/xParMgr.o(.text*);
        build/src/SB/Core/x/xPartition.o(.text*);
        build/src/SB/Core/x/xpkrsvc.o(.text*);
        build/src/SB/Core/x/xQuickCull.o(.text*);
        build/src/SB/Core/x/xsavegame.o(.text*);
        build/src/SB/Core/x/xScene.o(.text*);
        build/src/SB/Core/x/xScrFx.o(.text*);
        build/src/SB/Core/x/xserializer.o(.text*);
        build/src/SB/Core/x/xShadow.o(.text*);
        build/src/SB/Core/x/xSnd.o(.text*);
        build/src/SB/Core/x/xSpline.o(.text*);
        build/src/SB/Core/x/xstransvc.o(.text*);
        build/src/SB/Core/x/xString.o(.text*);
        build/src/SB/Core/x/xSurface.o(.text*);
        build/src/SB/Core/x/xTRC.o(.text*);
        build/src/SB/Core/x/xutil.o(.text*);
        build/src/SB/Core/x/xVec3.o(.text*);
        build/src/SB/Core/x/xAnim.o(.text*);
        build/src/SB/Game/zThrown.o(.text*);
        build/src/SB/Core/x/xEvent.o(.text*);
        build/src/SB/Core/x/xHud.o(.text*);
        build/src/SB/Core/x/xHudFontMeter.o(.text*);
        build/src/SB/Core/x/xHudMeter.o(.text*);
        build/src/SB/Core/x/xHudModel.o(.text*);
        build/src/SB/Core/x/xHudUnitMeter.o(.text*);
        build/src/SB/Game/zLasso.o(.text*);
        build/src/SB/Game/zPickupTable.o(.text*);
        build/src/SB/Core/x/xCounter.o(.text*);
        build/src/SB/Core/x/xTimer.o(.text*);
        build/src/SB/Core/x/xFog.o(.text*);
        build/src/SB/Core/x/xSFX.o(.text*);
        build/src/SB/Core/x/xGroup.o(.text*);
        build/src/SB/Game/zEntCruiseBubble.o(.text*);
        build/src/SB/Core/x/xSkyDome.o(.text*);
        build/src/SB/Game/zNPCGoalRobo.o(.text*);
        build/src/SB/Core/x/xListItem.o(.text*);
        build/src/SB/Game/zNPCGoals.o(.text*);
        build/src/SB/Game/zNPCGoalStd.o(.text*);
        build/src/SB/Game/zNPCGoalTiki.o(.text*);
        build/src/SB/Game/zNPCGoalCommon.o(.text*);
        build/src/SB/Game/zNPCMessenger.o(.text*);
        build/src/SB/Game/zNPCMgr.o(.text*);
        build/src/SB/Game/zNPCTypeAmbient.o(.text*);
        build/src/SB/Game/zNPCTypeCommon.o(.text*);
        build/src/SB/Core/x/xListItem.o(.text*);
        build/src/SB/Game/zNPCTypeRobot.o(.text*);
        build/src/SB/Game/zNPCTypes.o(.text*);
        build/src/SB/Game/zNPCTypeTiki.o(.text*);
        build/src/SB/Game/zNPCTypeVillager.o(.text*);
        build/src/SB/Core/x/xBehaveMgr.o(.text*);
        build/src/SB/Core/x/xListItem.o(.text*);
        build/src/SB/Core/x/xBehaviour.o(.text*);
        build/src/SB/Core/x/xFactory.o(.text*);
        build/src/SB/Core/x/xNPCBasic.o(.text*);
        build/src/SB/Core/x/xRMemData.o(.text*);
        build/src/SB/Core/x/xBehaveGoalSimple.o(.text*);
        build/src/SB/Game/zCollGeom.o(.text*);
        build/src/SB/Game/zEntPlayerBungeeState.o(.text*);
        build/src/SB/Core/x/xParSys.o(.text*);
        build/src/SB/Core/x/xParEmitter.o(.text*);
        build/src/SB/Core/x/xVolume.o(.text*);
        build/src/SB/Core/x/xParEmitterType.o(.text*);
        build/src/SB/Core/x/xRenderState.o(.text*);
        build/src/SB/Core/x/xJSP.o(.text*);
        build/src/SB/Core/x/xClumpColl.o(.text*);
        build/src/SB/Core/x/xGrid.o(.text*);
        build/src/SB/Core/x/xLightKit.o(.text*);
        build/src/SB/Game/zGrid.o(.text*);
        build/src/SB/Core/x/xEntBoulder.o(.text*);
        build/src/SB/Game/zEntPlayerOOBState.o(.text*);
        build/src/SB/Game/zNPCTypeDuplotron.o(.text*);
        build/src/SB/Game/zGoo.o(.text*);
        build/src/SB/Game/zNPCGoalScript.o(.text*);
        build/src/SB/Game/zNPCSndTable.o(.text*);
        build/src/SB/Game/zCamMarker.o(.text*);
        build/src/SB/Core/x/xModelBucket.o(.text*);
        build/src/SB/Game/zShrapnel.o(.text*);
        build/src/SB/Game/zNPCSpawner.o(.text*);
        build/src/SB/Game/zEntTeleportBox.o(.text*);
        build/src/SB/Game/zNPCGoalDuplotron.o(.text*);
        build/src/SB/Game/zBusStop.o(.text*);
        build/src/SB/Game/zNPCSupport.o(.text*);
        build/src/SB/Game/zTalkBox.o(.text*);
        build/src/SB/Game/zTextBox.o(.text*);
        build/src/SB/Game/zTaskBox.o(.text*);
        build/src/SB/Game/zNPCTypeTest.o(.text*);
        build/src/SB/Game/zNPCGoalSubBoss.o(.text*);
        build/src/SB/Game/zNPCTypeBoss.o(.text*);
        build/src/SB/Game/zNPCGoalBoss.o(.text*);
        build/src/SB/Game/zNPCTypeSubBoss.o(.text*);
        build/src/SB/Game/zNPCGoalVillager.o(.text*);
        build/src/SB/Core/x/xUpdateCull.o(.text*);
        build/src/SB/Core/p2/iFXGoo.o(.text*);
        build/src/SB/Core/x/xShadowSimple.o(.text*);
        build/src/SB/Game/zNPCTypeBossSandy.o(.text*);
        build/src/SB/Game/zDiscoFloor.o(.text*);
        build/src/SB/Core/p2/iFXshadow.o(.text*);
        build/src/SB/Game/zNPCTypeKingJelly.o(.text*);
        build/src/SB/Core/p2/his/HisStubs.o(.text*);
        build/src/SB/Core/p2/his/HISAPI.o(.text*);
        build/src/SB/Core/p2/iCutscene.o(.text*);
        build/src/SB/Game/zNPCTypeBossSB2.o(.text*);
        build/src/SB/Game/zNPCTypeBossSB1.o(.text*);
        build/src/SB/Core/x/iCamera.o(.text*);
        build/src/SB/Core/x/xJaw.o(.text*);
        build/src/SB/Game/zNPCTypePrawn.o(.text*);
        build/src/SB/Game/zNPCTypeBossPlankton.o(.text*);
        build/src/SB/Game/zNPCTypeBossPatrick.o(.text*);
        build/src/SB/Core/p2/iVU0.o(.text*);
        build/src/SB/Game/zParPTank.o(.text*);
        build/src/SB/Game/zTaxi.o(.text*);
        build/src/SB/Game/zNPCTypeDutchman.o(.text*);
        build/src/SB/Game/zCameraFly.o(.text*);
        build/src/SB/Core/x/xCurveAsset.o(.text*);
        build/src/SB/Core/p2/iModelBucketPDS.o(.text*);
        build/src/SB/Core/x/xDecal.o(.text*);
        build/src/SB/Core/x/xPtankPool.o(.text*);
        build/src/SB/Core/x/xLaserBolt.o(.text*);
        build/src/SB/Game/zCameraTweak.o(.text*);
        build/src/SB/Game/zNPCSupplement.o(.text*);
        build/src/SB/Game/zNPCGoalAmbient.o(.text*);
        build/src/SB/Game/zNPCHazard.o(.text*);
        build/src/SB/Game/zNPCGlyph.o(.text*);
        build/src/SB/Game/zNPCFXCinematic.o(.text*);
        build/src/SB/Game/zCombo.o(.text*);
        build/src/SB/Core/x/xHudText.o(.text*);
        build/src/SB/Core/x/xCM.o(.text*);
        build/src/SB/Core/p2/iException.o(.text*);
        build/asm/data/cod/3209C0.o(.text*);
        . = ALIGN(., 16);
        cod_TEXT_END = .;
        cod_TEXT_SIZE = ABSOLUTE(cod_TEXT_END - cod_TEXT_START);
        cod_DATA_START = .;
        build/asm/cod/000000.o(.data*);
        build/src/SB/Game/zAnimList.o(.data*);
        build/src/SB/Game/zAssetTypes.o(.data*);
        build/src/SB/Game/zCamera.o(.data*);
        build/src/SB/Game/zConditional.o(.data*);
        build/src/SB/Game/zCutsceneMgr.o(.data*);
        build/src/SB/Game/zDispatcher.o(.data*);
        build/src/SB/Game/zEGenerator.o(.data*);
        build/src/SB/Game/zEnt.o(.data*);
        build/src/SB/Game/zEntButton.o(.data*);
        build/src/SB/Game/zEntDestructObj.o(.data*);
        build/src/SB/Game/zEntHangable.o(.data*);
        build/src/SB/Game/zEntPickup.o(.data*);
        build/src/SB/Game/zEntPlayer.o(.data*);
        build/src/SB/Game/zEntSimpleObj.o(.data*);
        build/src/SB/Game/zEntTrigger.o(.data*);
        build/src/SB/Game/zEnv.o(.data*);
        build/src/SB/Game/zEvent.o(.data*);
        build/src/SB/Game/zFeet.o(.data*);
        build/src/SB/Game/zFMV.o(.data*);
        build/src/SB/Game/zFX.o(.data*);
        build/src/SB/Game/zGame.o(.data*);
        build/src/SB/Game/zGameExtras.o(.data*);
        build/src/SB/Game/zGameState.o(.data*);
        build/src/SB/Game/zGust.o(.data*);
        build/src/SB/Game/zHud.o(.data*);
        build/src/SB/Game/zLight.o(.data*);
        build/src/SB/Game/zLightEffect.o(.data*);
        build/src/SB/Game/zLightning.o(.data*);
        build/src/SB/Game/zLOD.o(.data*);
        build/src/SB/Game/zMain.o(.data*);
        build/src/SB/Game/zMenu.o(.data*);
        build/src/SB/Game/zMovePoint.o(.data*);
        build/src/SB/Game/zMusic.o(.data*);
        build/src/SB/Game/zParCmd.o(.data*);
        build/src/SB/Game/zParEmitter.o(.data*);
        build/src/SB/Game/zPendulum.o(.data*);
        build/src/SB/Game/zPlatform.o(.data*);
        build/src/SB/Game/zPortal.o(.data*);
        build/src/SB/Game/zRenderState.o(.data*);
        build/src/SB/Game/zRumble.o(.data*);
        build/src/SB/Game/zSaveLoad.o(.data*);
        build/src/SB/Game/zScene.o(.data*);
        build/src/SB/Game/zScript.o(.data*);
        build/src/SB/Game/zSurface.o(.data*);
        build/src/SB/Game/zUI.o(.data*);
        build/src/SB/Game/zUIFont.o(.data*);
        build/src/SB/Game/zVar.o(.data*);
        build/src/SB/Game/zVolume.o(.data*);
        build/src/SB/Game/zActionLine.o(.data*);
        build/src/SB/Core/p2/iAnimSKB.o(.data*);
        build/src/SB/Core/p2/iCollide.o(.data*);
        build/src/SB/Core/p2/iCollideFast.o(.data*);
        build/src/SB/Core/p2/iDraw.o(.data*);
        build/src/SB/Core/p2/iEnv.o(.data*);
        build/src/SB/Core/p2/iFile.o(.data*);
        build/src/SB/Core/p2/iFMV.o(.data*);
        build/src/SB/Core/p2/iFX.o(.data*);
        build/src/SB/Core/p2/iLight.o(.data*);
        build/src/SB/Core/p2/iMath3.o(.data*);
        build/src/SB/Core/p2/iMemMgr.o(.data*);
        build/src/SB/Core/p2/iModel.o(.data*);
        build/src/SB/Core/p2/iMorph.o(.data*);
        build/src/SB/Core/p2/iPad.o(.data*);
        build/src/SB/Core/p2/iParMgr.o(.data*);
        build/src/SB/Core/p2/isavegame.o(.data*);
        build/src/SB/Core/p2/iScrFX.o(.data*);
        build/src/SB/Core/p2/iSnd.o(.data*);
        build/src/SB/Core/p2/iSystem.o(.data*);
        build/src/SB/Core/p2/iTime.o(.data*);
        build/src/SB/Core/p2/p2im3dhack.o(.data*);
        build/src/SB/Core/p2/iAnim.o(.data*);
        build/src/SB/Core/p2/ps2_mpeg/audiodec.o(.data*);
        build/src/SB/Core/p2/ps2_mpeg/disp.o(.data*);
        build/src/SB/Core/p2/ps2_mpeg/ps2_mpeg.o(.data*);
        build/src/SB/Core/p2/ps2_mpeg/read.o(.data*);
        build/src/SB/Core/p2/ps2_mpeg/readbuf.o(.data*);
        build/src/SB/Core/p2/ps2_mpeg/strfile.o(.data*);
        build/src/SB/Core/p2/ps2_mpeg/vibuf.o(.data*);
        build/src/SB/Core/p2/ps2_mpeg/videodec.o(.data*);
        build/src/SB/Core/p2/ps2_mpeg/vobuf.o(.data*);
        build/src/SB/Core/x/xBase.o(.data*);
        build/src/SB/Core/x/xbinio.o(.data*);
        build/src/SB/Core/x/xBound.o(.data*);
        build/src/SB/Core/x/xCamera.o(.data*);
        build/src/SB/Core/x/xClimate.o(.data*);
        build/src/SB/Core/x/xCollide.o(.data*);
        build/src/SB/Core/x/xCollideFast.o(.data*);
        build/src/SB/Core/x/xCutscene.o(.data*);
        build/src/SB/Core/x/xDebug.o(.data*);
        build/src/SB/Core/x/xEnt.o(.data*);
        build/src/SB/Core/x/xEntDrive.o(.data*);
        build/src/SB/Core/x/xEntMotion.o(.data*);
        build/src/SB/Core/x/xEnv.o(.data*);
        build/src/SB/Core/x/xFFX.o(.data*);
        build/src/SB/Core/x/xFont.o(.data*);
        build/src/SB/Core/x/xFX.o(.data*);
        build/src/SB/Core/x/xhipio.o(.data*);
        build/src/SB/Core/x/xIni.o(.data*);
        build/src/SB/Core/x/xMath.o(.data*);
        build/src/SB/Core/x/xMath3.o(.data*);
        build/src/SB/Core/x/xMemMgr.o(.data*);
        build/src/SB/Core/x/xModel.o(.data*);
        build/src/SB/Core/x/xMorph.o(.data*);
        build/src/SB/Core/x/xMovePoint.o(.data*);
        build/src/SB/Core/x/xordarray.o(.data*);
        build/src/SB/Core/x/xPad.o(.data*);
        build/src/SB/Core/x/xPar.o(.data*);
        build/src/SB/Core/x/xParCmd.o(.data*);
        build/src/SB/Core/x/xParGroup.o(.data*);
        build/src/SB/Core/x/xParMgr.o(.data*);
        build/src/SB/Core/x/xPartition.o(.data*);
        build/src/SB/Core/x/xpkrsvc.o(.data*);
        build/src/SB/Core/x/xQuickCull.o(.data*);
        build/src/SB/Core/x/xsavegame.o(.data*);
        build/src/SB/Core/x/xScene.o(.data*);
        build/src/SB/Core/x/xScrFx.o(.data*);
        build/src/SB/Core/x/xserializer.o(.data*);
        build/src/SB/Core/x/xShadow.o(.data*);
        build/src/SB/Core/x/xSnd.o(.data*);
        build/src/SB/Core/x/xSpline.o(.data*);
        build/src/SB/Core/x/xstransvc.o(.data*);
        build/src/SB/Core/x/xString.o(.data*);
        build/src/SB/Core/x/xSurface.o(.data*);
        build/src/SB/Core/x/xTRC.o(.data*);
        build/src/SB/Core/x/xutil.o(.data*);
        build/src/SB/Core/x/xVec3.o(.data*);
        build/src/SB/Core/x/xAnim.o(.data*);
        build/src/SB/Game/zThrown.o(.data*);
        build/src/SB/Core/x/xEvent.o(.data*);
        build/src/SB/Core/x/xHud.o(.data*);
        build/src/SB/Core/x/xHudFontMeter.o(.data*);
        build/src/SB/Core/x/xHudMeter.o(.data*);
        build/src/SB/Core/x/xHudModel.o(.data*);
        build/src/SB/Core/x/xHudUnitMeter.o(.data*);
        build/src/SB/Game/zLasso.o(.data*);
        build/src/SB/Game/zPickupTable.o(.data*);
        build/src/SB/Core/x/xCounter.o(.data*);
        build/src/SB/Core/x/xTimer.o(.data*);
        build/src/SB/Core/x/xFog.o(.data*);
        build/src/SB/Core/x/xSFX.o(.data*);
        build/src/SB/Core/x/xGroup.o(.data*);
        build/src/SB/Game/zEntCruiseBubble.o(.data*);
        build/src/SB/Core/x/xSkyDome.o(.data*);
        build/src/SB/Game/zNPCGoalRobo.o(.data*);
        build/src/SB/Core/x/xListItem.o(.data*);
        build/src/SB/Game/zNPCGoals.o(.data*);
        build/src/SB/Game/zNPCGoalStd.o(.data*);
        build/src/SB/Game/zNPCGoalTiki.o(.data*);
        build/src/SB/Game/zNPCGoalCommon.o(.data*);
        build/src/SB/Game/zNPCMessenger.o(.data*);
        build/src/SB/Game/zNPCMgr.o(.data*);
        build/src/SB/Game/zNPCTypeAmbient.o(.data*);
        build/src/SB/Game/zNPCTypeCommon.o(.data*);
        build/src/SB/Game/zNPCTypeRobot.o(.data*);
        build/src/SB/Game/zNPCTypes.o(.data*);
        build/src/SB/Game/zNPCTypeTiki.o(.data*);
        build/src/SB/Game/zNPCTypeVillager.o(.data*);
        build/src/SB/Core/x/xBehaveMgr.o(.data*);
        build/src/SB/Core/x/xBehaviour.o(.data*);
        build/src/SB/Core/x/xFactory.o(.data*);
        build/src/SB/Core/x/xNPCBasic.o(.data*);
        build/src/SB/Core/x/xRMemData.o(.data*);
        build/src/SB/Core/x/xBehaveGoalSimple.o(.data*);
        build/src/SB/Game/zCollGeom.o(.data*);
        build/src/SB/Game/zEntPlayerBungeeState.o(.data*);
        build/src/SB/Core/x/xParSys.o(.data*);
        build/src/SB/Core/x/xParEmitter.o(.data*);
        build/src/SB/Core/x/xVolume.o(.data*);
        build/src/SB/Core/x/xParEmitterType.o(.data*);
        build/src/SB/Core/x/xRenderState.o(.data*);
        build/src/SB/Core/x/xJSP.o(.data*);
        build/src/SB/Core/x/xClumpColl.o(.data*);
        build/src/SB/Core/x/xGrid.o(.data*);
        build/src/SB/Core/x/xLightKit.o(.data*);
        build/src/SB/Game/zGrid.o(.data*);
        build/src/SB/Core/x/xEntBoulder.o(.data*);
        build/src/SB/Game/zEntPlayerOOBState.o(.data*);
        build/src/SB/Game/zNPCTypeDuplotron.o(.data*);
        build/src/SB/Game/zGoo.o(.data*);
        build/src/SB/Game/zNPCGoalScript.o(.data*);
        build/src/SB/Game/zNPCSndTable.o(.data*);
        build/src/SB/Game/zCamMarker.o(.data*);
        build/src/SB/Core/x/xModelBucket.o(.data*);
        build/src/SB/Game/zShrapnel.o(.data*);
        build/src/SB/Game/zNPCSpawner.o(.data*);
        build/src/SB/Game/zEntTeleportBox.o(.data*);
        build/src/SB/Game/zNPCGoalDuplotron.o(.data*);
        build/src/SB/Game/zBusStop.o(.data*);
        build/src/SB/Game/zNPCSupport.o(.data*);
        build/src/SB/Game/zTalkBox.o(.data*);
        build/src/SB/Game/zTextBox.o(.data*);
        build/src/SB/Game/zTaskBox.o(.data*);
        build/src/SB/Game/zNPCTypeTest.o(.data*);
        build/src/SB/Game/zNPCGoalSubBoss.o(.data*);
        build/src/SB/Game/zNPCTypeBoss.o(.data*);
        build/src/SB/Game/zNPCGoalBoss.o(.data*);
        build/src/SB/Game/zNPCTypeSubBoss.o(.data*);
        build/src/SB/Game/zNPCGoalVillager.o(.data*);
        build/src/SB/Core/x/xUpdateCull.o(.data*);
        build/src/SB/Core/p2/iFXGoo.o(.data*);
        build/src/SB/Core/x/xShadowSimple.o(.data*);
        build/src/SB/Game/zNPCTypeBossSandy.o(.data*);
        build/src/SB/Game/zDiscoFloor.o(.data*);
        build/src/SB/Core/p2/iFXshadow.o(.data*);
        build/src/SB/Game/zNPCTypeKingJelly.o(.data*);
        build/src/SB/Core/p2/his/HisStubs.o(.data*);
        build/src/SB/Core/p2/his/HISAPI.o(.data*);
        build/src/SB/Core/p2/iCutscene.o(.data*);
        build/src/SB/Game/zNPCTypeBossSB2.o(.data*);
        build/src/SB/Game/zNPCTypeBossSB1.o(.data*);
        build/src/SB/Core/x/iCamera.o(.data*);
        build/src/SB/Core/x/xJaw.o(.data*);
        build/src/SB/Game/zNPCTypePrawn.o(.data*);
        build/src/SB/Game/zNPCTypeBossPlankton.o(.data*);
        build/src/SB/Game/zNPCTypeBossPatrick.o(.data*);
        build/src/SB/Core/p2/iVU0.o(.data*);
        build/src/SB/Game/zParPTank.o(.data*);
        build/src/SB/Game/zTaxi.o(.data*);
        build/src/SB/Game/zNPCTypeDutchman.o(.data*);
        build/src/SB/Game/zCameraFly.o(.data*);
        build/src/SB/Core/x/xCurveAsset.o(.data*);
        build/src/SB/Core/p2/iModelBucketPDS.o(.data*);
        build/src/SB/Core/x/xDecal.o(.data*);
        build/src/SB/Core/x/xPtankPool.o(.data*);
        build/src/SB/Core/x/xLaserBolt.o(.data*);
        build/src/SB/Game/zCameraTweak.o(.data*);
        build/src/SB/Game/zNPCSupplement.o(.data*);
        build/src/SB/Game/zNPCGoalAmbient.o(.data*);
        build/src/SB/Game/zNPCHazard.o(.data*);
        build/src/SB/Game/zNPCGlyph.o(.data*);
        build/src/SB/Game/zNPCFXCinematic.o(.data*);
        build/src/SB/Game/zCombo.o(.data*);
        build/src/SB/Core/x/xHudText.o(.data*);
        build/src/SB/Core/x/xCM.o(.data*);
        build/src/SB/Core/p2/iException.o(.data*);
        build/asm/data/cod/3209C0.o(.data*);
        build/asm/data/cod/324680.data.o(.data*);
        . = ALIGN(., 16);
        cod_DATA_END = .;
        cod_DATA_SIZE = ABSOLUTE(cod_DATA_END - cod_DATA_START);
        cod_RODATA_START = .;
        build/asm/cod/000000.o(.rodata*);
        build/src/SB/Game/zAnimList.o(.rodata*);
        build/src/SB/Game/zAssetTypes.o(.rodata*);
        build/src/SB/Game/zCamera.o(.rodata*);
        build/src/SB/Game/zConditional.o(.rodata*);
        build/src/SB/Game/zCutsceneMgr.o(.rodata*);
        build/src/SB/Game/zDispatcher.o(.rodata*);
        build/src/SB/Game/zEGenerator.o(.rodata*);
        build/src/SB/Game/zEnt.o(.rodata*);
        build/src/SB/Game/zEntButton.o(.rodata*);
        build/src/SB/Game/zEntDestructObj.o(.rodata*);
        build/src/SB/Game/zEntHangable.o(.rodata*);
        build/src/SB/Game/zEntPickup.o(.rodata*);
        build/src/SB/Game/zEntPlayer.o(.rodata*);
        build/src/SB/Game/zEntSimpleObj.o(.rodata*);
        build/src/SB/Game/zEntTrigger.o(.rodata*);
        build/src/SB/Game/zEnv.o(.rodata*);
        build/src/SB/Game/zEvent.o(.rodata*);
        build/src/SB/Game/zFeet.o(.rodata*);
        build/src/SB/Game/zFMV.o(.rodata*);
        build/src/SB/Game/zFX.o(.rodata*);
        build/src/SB/Game/zGame.o(.rodata*);
        build/src/SB/Game/zGameExtras.o(.rodata*);
        build/src/SB/Game/zGameState.o(.rodata*);
        build/src/SB/Game/zGust.o(.rodata*);
        build/src/SB/Game/zHud.o(.rodata*);
        build/src/SB/Game/zLight.o(.rodata*);
        build/src/SB/Game/zLightEffect.o(.rodata*);
        build/src/SB/Game/zLightning.o(.rodata*);
        build/src/SB/Game/zLOD.o(.rodata*);
        build/src/SB/Game/zMain.o(.rodata*);
        build/src/SB/Game/zMenu.o(.rodata*);
        build/src/SB/Game/zMovePoint.o(.rodata*);
        build/src/SB/Game/zMusic.o(.rodata*);
        build/src/SB/Game/zParCmd.o(.rodata*);
        build/src/SB/Game/zParEmitter.o(.rodata*);
        build/src/SB/Game/zPendulum.o(.rodata*);
        build/src/SB/Game/zPlatform.o(.rodata*);
        build/src/SB/Game/zPortal.o(.rodata*);
        build/src/SB/Game/zRenderState.o(.rodata*);
        build/src/SB/Game/zRumble.o(.rodata*);
        build/src/SB/Game/zSaveLoad.o(.rodata*);
        build/src/SB/Game/zScene.o(.rodata*);
        build/src/SB/Game/zScript.o(.rodata*);
        build/src/SB/Game/zSurface.o(.rodata*);
        build/src/SB/Game/zUI.o(.rodata*);
        build/src/SB/Game/zUIFont.o(.rodata*);
        build/src/SB/Game/zVar.o(.rodata*);
        build/src/SB/Game/zVolume.o(.rodata*);
        build/src/SB/Game/zActionLine.o(.rodata*);
        build/src/SB/Core/p2/iAnimSKB.o(.rodata*);
        build/src/SB/Core/p2/iCollide.o(.rodata*);
        build/src/SB/Core/p2/iCollideFast.o(.rodata*);
        build/src/SB/Core/p2/iDraw.o(.rodata*);
        build/src/SB/Core/p2/iEnv.o(.rodata*);
        build/src/SB/Core/p2/iFile.o(.rodata*);
        build/src/SB/Core/p2/iFMV.o(.rodata*);
        build/src/SB/Core/p2/iFX.o(.rodata*);
        build/src/SB/Core/p2/iLight.o(.rodata*);
        build/src/SB/Core/p2/iMath3.o(.rodata*);
        build/src/SB/Core/p2/iMemMgr.o(.rodata*);
        build/src/SB/Core/p2/iModel.o(.rodata*);
        build/src/SB/Core/p2/iMorph.o(.rodata*);
        build/src/SB/Core/p2/iPad.o(.rodata*);
        build/src/SB/Core/p2/iParMgr.o(.rodata*);
        build/src/SB/Core/p2/isavegame.o(.rodata*);
        build/src/SB/Core/p2/iScrFX.o(.rodata*);
        build/src/SB/Core/p2/iSnd.o(.rodata*);
        build/src/SB/Core/p2/iSystem.o(.rodata*);
        build/src/SB/Core/p2/iTime.o(.rodata*);
        build/src/SB/Core/p2/p2im3dhack.o(.rodata*);
        build/src/SB/Core/p2/iAnim.o(.rodata*);
        build/src/SB/Core/p2/ps2_mpeg/audiodec.o(.rodata*);
        build/src/SB/Core/p2/ps2_mpeg/disp.o(.rodata*);
        build/src/SB/Core/p2/ps2_mpeg/ps2_mpeg.o(.rodata*);
        build/src/SB/Core/p2/ps2_mpeg/read.o(.rodata*);
        build/src/SB/Core/p2/ps2_mpeg/readbuf.o(.rodata*);
        build/src/SB/Core/p2/ps2_mpeg/strfile.o(.rodata*);
        build/src/SB/Core/p2/ps2_mpeg/vibuf.o(.rodata*);
        build/src/SB/Core/p2/ps2_mpeg/videodec.o(.rodata*);
        build/src/SB/Core/p2/ps2_mpeg/vobuf.o(.rodata*);
        build/src/SB/Core/x/xBase.o(.rodata*);
        build/src/SB/Core/x/xbinio.o(.rodata*);
        build/src/SB/Core/x/xBound.o(.rodata*);
        build/src/SB/Core/x/xCamera.o(.rodata*);
        build/src/SB/Core/x/xClimate.o(.rodata*);
        build/src/SB/Core/x/xCollide.o(.rodata*);
        build/src/SB/Core/x/xCollideFast.o(.rodata*);
        build/src/SB/Core/x/xCutscene.o(.rodata*);
        build/src/SB/Core/x/xDebug.o(.rodata*);
        build/src/SB/Core/x/xEnt.o(.rodata*);
        build/src/SB/Core/x/xEntDrive.o(.rodata*);
        build/src/SB/Core/x/xEntMotion.o(.rodata*);
        build/src/SB/Core/x/xEnv.o(.rodata*);
        build/src/SB/Core/x/xFFX.o(.rodata*);
        build/src/SB/Core/x/xFont.o(.rodata*);
        build/src/SB/Core/x/xFX.o(.rodata*);
        build/src/SB/Core/x/xhipio.o(.rodata*);
        build/src/SB/Core/x/xIni.o(.rodata*);
        build/src/SB/Core/x/xMath.o(.rodata*);
        build/src/SB/Core/x/xMath3.o(.rodata*);
        build/src/SB/Core/x/xMemMgr.o(.rodata*);
        build/src/SB/Core/x/xModel.o(.rodata*);
        build/src/SB/Core/x/xMorph.o(.rodata*);
        build/src/SB/Core/x/xMovePoint.o(.rodata*);
        build/src/SB/Core/x/xordarray.o(.rodata*);
        build/src/SB/Core/x/xPad.o(.rodata*);
        build/src/SB/Core/x/xPar.o(.rodata*);
        build/src/SB/Core/x/xParCmd.o(.rodata*);
        build/src/SB/Core/x/xParGroup.o(.rodata*);
        build/src/SB/Core/x/xParMgr.o(.rodata*);
        build/src/SB/Core/x/xPartition.o(.rodata*);
        build/src/SB/Core/x/xpkrsvc.o(.rodata*);
        build/src/SB/Core/x/xQuickCull.o(.rodata*);
        build/src/SB/Core/x/xsavegame.o(.rodata*);
        build/src/SB/Core/x/xScene.o(.rodata*);
        build/src/SB/Core/x/xScrFx.o(.rodata*);
        build/src/SB/Core/x/xserializer.o(.rodata*);
        build/src/SB/Core/x/xShadow.o(.rodata*);
        build/src/SB/Core/x/xSnd.o(.rodata*);
        build/src/SB/Core/x/xSpline.o(.rodata*);
        build/src/SB/Core/x/xstransvc.o(.rodata*);
        build/src/SB/Core/x/xString.o(.rodata*);
        build/src/SB/Core/x/xSurface.o(.rodata*);
        build/src/SB/Core/x/xTRC.o(.rodata*);
        build/src/SB/Core/x/xutil.o(.rodata*);
        build/src/SB/Core/x/xVec3.o(.rodata*);
        build/src/SB/Core/x/xAnim.o(.rodata*);
        build/src/SB/Game/zThrown.o(.rodata*);
        build/src/SB/Core/x/xEvent.o(.rodata*);
        build/src/SB/Core/x/xHud.o(.rodata*);
        build/src/SB/Core/x/xHudFontMeter.o(.rodata*);
        build/src/SB/Core/x/xHudMeter.o(.rodata*);
        build/src/SB/Core/x/xHudModel.o(.rodata*);
        build/src/SB/Core/x/xHudUnitMeter.o(.rodata*);
        build/src/SB/Game/zLasso.o(.rodata*);
        build/src/SB/Game/zPickupTable.o(.rodata*);
        build/src/SB/Core/x/xCounter.o(.rodata*);
        build/src/SB/Core/x/xTimer.o(.rodata*);
        build/src/SB/Core/x/xFog.o(.rodata*);
        build/src/SB/Core/x/xSFX.o(.rodata*);
        build/src/SB/Core/x/xGroup.o(.rodata*);
        build/src/SB/Game/zEntCruiseBubble.o(.rodata*);
        build/src/SB/Core/x/xSkyDome.o(.rodata*);
        build/src/SB/Game/zNPCGoalRobo.o(.rodata*);
        build/src/SB/Core/x/xListItem.o(.rodata*);
        build/src/SB/Game/zNPCGoals.o(.rodata*);
        build/src/SB/Game/zNPCGoalStd.o(.rodata*);
        build/src/SB/Game/zNPCGoalTiki.o(.rodata*);
        build/src/SB/Game/zNPCGoalCommon.o(.rodata*);
        build/src/SB/Game/zNPCMessenger.o(.rodata*);
        build/src/SB/Game/zNPCMgr.o(.rodata*);
        build/src/SB/Game/zNPCTypeAmbient.o(.rodata*);
        build/src/SB/Game/zNPCTypeCommon.o(.rodata*);
        build/src/SB/Game/zNPCTypeRobot.o(.rodata*);
        build/src/SB/Game/zNPCTypes.o(.rodata*);
        build/src/SB/Game/zNPCTypeTiki.o(.rodata*);
        build/src/SB/Game/zNPCTypeVillager.o(.rodata*);
        build/src/SB/Core/x/xBehaveMgr.o(.rodata*);
        build/src/SB/Core/x/xBehaviour.o(.rodata*);
        build/src/SB/Core/x/xFactory.o(.rodata*);
        build/src/SB/Core/x/xNPCBasic.o(.rodata*);
        build/src/SB/Core/x/xRMemData.o(.rodata*);
        build/src/SB/Core/x/xBehaveGoalSimple.o(.rodata*);
        build/src/SB/Game/zCollGeom.o(.rodata*);
        build/src/SB/Game/zEntPlayerBungeeState.o(.rodata*);
        build/src/SB/Core/x/xParSys.o(.rodata*);
        build/src/SB/Core/x/xParEmitter.o(.rodata*);
        build/src/SB/Core/x/xVolume.o(.rodata*);
        build/src/SB/Core/x/xParEmitterType.o(.rodata*);
        build/src/SB/Core/x/xRenderState.o(.rodata*);
        build/src/SB/Core/x/xJSP.o(.rodata*);
        build/src/SB/Core/x/xClumpColl.o(.rodata*);
        build/src/SB/Core/x/xGrid.o(.rodata*);
        build/src/SB/Core/x/xLightKit.o(.rodata*);
        build/src/SB/Game/zGrid.o(.rodata*);
        build/src/SB/Core/x/xEntBoulder.o(.rodata*);
        build/src/SB/Game/zEntPlayerOOBState.o(.rodata*);
        build/src/SB/Game/zNPCTypeDuplotron.o(.rodata*);
        build/src/SB/Game/zGoo.o(.rodata*);
        build/src/SB/Game/zNPCGoalScript.o(.rodata*);
        build/src/SB/Game/zNPCSndTable.o(.rodata*);
        build/src/SB/Game/zCamMarker.o(.rodata*);
        build/src/SB/Core/x/xModelBucket.o(.rodata*);
        build/src/SB/Game/zShrapnel.o(.rodata*);
        build/src/SB/Game/zNPCSpawner.o(.rodata*);
        build/src/SB/Game/zEntTeleportBox.o(.rodata*);
        build/src/SB/Game/zNPCGoalDuplotron.o(.rodata*);
        build/src/SB/Game/zBusStop.o(.rodata*);
        build/src/SB/Game/zNPCSupport.o(.rodata*);
        build/src/SB/Game/zTalkBox.o(.rodata*);
        build/src/SB/Game/zTextBox.o(.rodata*);
        build/src/SB/Game/zTaskBox.o(.rodata*);
        build/src/SB/Game/zNPCTypeTest.o(.rodata*);
        build/src/SB/Game/zNPCGoalSubBoss.o(.rodata*);
        build/src/SB/Game/zNPCTypeBoss.o(.rodata*);
        build/src/SB/Game/zNPCGoalBoss.o(.rodata*);
        build/src/SB/Game/zNPCTypeSubBoss.o(.rodata*);
        build/src/SB/Game/zNPCGoalVillager.o(.rodata*);
        build/src/SB/Core/x/xUpdateCull.o(.rodata*);
        build/src/SB/Core/p2/iFXGoo.o(.rodata*);
        build/src/SB/Core/x/xShadowSimple.o(.rodata*);
        build/src/SB/Game/zNPCTypeBossSandy.o(.rodata*);
        build/src/SB/Game/zDiscoFloor.o(.rodata*);
        build/src/SB/Core/p2/iFXshadow.o(.rodata*);
        build/src/SB/Game/zNPCTypeKingJelly.o(.rodata*);
        build/src/SB/Core/p2/his/HisStubs.o(.rodata*);
        build/src/SB/Core/p2/his/HISAPI.o(.rodata*);
        build/src/SB/Core/p2/iCutscene.o(.rodata*);
        build/src/SB/Game/zNPCTypeBossSB2.o(.rodata*);
        build/src/SB/Game/zNPCTypeBossSB1.o(.rodata*);
        build/src/SB/Core/x/iCamera.o(.rodata*);
        build/src/SB/Core/x/xJaw.o(.rodata*);
        build/src/SB/Game/zNPCTypePrawn.o(.rodata*);
        build/src/SB/Game/zNPCTypeBossPlankton.o(.rodata*);
        build/src/SB/Game/zNPCTypeBossPatrick.o(.rodata*);
        build/src/SB/Core/p2/iVU0.o(.rodata*);
        build/src/SB/Game/zParPTank.o(.rodata*);
        build/src/SB/Game/zTaxi.o(.rodata*);
        build/src/SB/Game/zNPCTypeDutchman.o(.rodata*);
        build/src/SB/Game/zCameraFly.o(.rodata*);
        build/src/SB/Core/x/xCurveAsset.o(.rodata*);
        build/src/SB/Core/p2/iModelBucketPDS.o(.rodata*);
        build/src/SB/Core/x/xDecal.o(.rodata*);
        build/src/SB/Core/x/xPtankPool.o(.rodata*);
        build/src/SB/Core/x/xLaserBolt.o(.rodata*);
        build/src/SB/Game/zCameraTweak.o(.rodata*);
        build/src/SB/Game/zNPCSupplement.o(.rodata*);
        build/src/SB/Game/zNPCGoalAmbient.o(.rodata*);
        build/src/SB/Game/zNPCHazard.o(.rodata*);
        build/src/SB/Game/zNPCGlyph.o(.rodata*);
        build/src/SB/Game/zNPCFXCinematic.o(.rodata*);
        build/src/SB/Game/zCombo.o(.rodata*);
        build/src/SB/Core/x/xHudText.o(.rodata*);
        build/src/SB/Core/x/xCM.o(.rodata*);
        build/src/SB/Core/p2/iException.o(.rodata*);
        build/asm/data/cod/3209C0.o(.rodata*);
        build/asm/data/cod/350100.rodata.o(.rodata*);
        . = ALIGN(., 16);
        cod_RODATA_END = .;
        cod_RODATA_SIZE = ABSOLUTE(cod_RODATA_END - cod_RODATA_START);
        cod_GCC_EXCEPT_TABLE_START = .;
        build/asm/cod/000000.o(.gcc_except_table*);
        build/src/SB/Game/zAnimList.o(.gcc_except_table*);
        build/src/SB/Game/zAssetTypes.o(.gcc_except_table*);
        build/src/SB/Game/zCamera.o(.gcc_except_table*);
        build/src/SB/Game/zConditional.o(.gcc_except_table*);
        build/src/SB/Game/zCutsceneMgr.o(.gcc_except_table*);
        build/src/SB/Game/zDispatcher.o(.gcc_except_table*);
        build/src/SB/Game/zEGenerator.o(.gcc_except_table*);
        build/src/SB/Game/zEnt.o(.gcc_except_table*);
        build/src/SB/Game/zEntButton.o(.gcc_except_table*);
        build/src/SB/Game/zEntDestructObj.o(.gcc_except_table*);
        build/src/SB/Game/zEntHangable.o(.gcc_except_table*);
        build/src/SB/Game/zEntPickup.o(.gcc_except_table*);
        build/src/SB/Game/zEntPlayer.o(.gcc_except_table*);
        build/src/SB/Game/zEntSimpleObj.o(.gcc_except_table*);
        build/src/SB/Game/zEntTrigger.o(.gcc_except_table*);
        build/src/SB/Game/zEnv.o(.gcc_except_table*);
        build/src/SB/Game/zEvent.o(.gcc_except_table*);
        build/src/SB/Game/zFeet.o(.gcc_except_table*);
        build/src/SB/Game/zFMV.o(.gcc_except_table*);
        build/src/SB/Game/zFX.o(.gcc_except_table*);
        build/src/SB/Game/zGame.o(.gcc_except_table*);
        build/src/SB/Game/zGameExtras.o(.gcc_except_table*);
        build/src/SB/Game/zGameState.o(.gcc_except_table*);
        build/src/SB/Game/zGust.o(.gcc_except_table*);
        build/src/SB/Game/zHud.o(.gcc_except_table*);
        build/src/SB/Game/zLight.o(.gcc_except_table*);
        build/src/SB/Game/zLightEffect.o(.gcc_except_table*);
        build/src/SB/Game/zLightning.o(.gcc_except_table*);
        build/src/SB/Game/zLOD.o(.gcc_except_table*);
        build/src/SB/Game/zMain.o(.gcc_except_table*);
        build/src/SB/Game/zMenu.o(.gcc_except_table*);
        build/src/SB/Game/zMovePoint.o(.gcc_except_table*);
        build/src/SB/Game/zMusic.o(.gcc_except_table*);
        build/src/SB/Game/zParCmd.o(.gcc_except_table*);
        build/src/SB/Game/zParEmitter.o(.gcc_except_table*);
        build/src/SB/Game/zPendulum.o(.gcc_except_table*);
        build/src/SB/Game/zPlatform.o(.gcc_except_table*);
        build/src/SB/Game/zPortal.o(.gcc_except_table*);
        build/src/SB/Game/zRenderState.o(.gcc_except_table*);
        build/src/SB/Game/zRumble.o(.gcc_except_table*);
        build/src/SB/Game/zSaveLoad.o(.gcc_except_table*);
        build/src/SB/Game/zScene.o(.gcc_except_table*);
        build/src/SB/Game/zScript.o(.gcc_except_table*);
        build/src/SB/Game/zSurface.o(.gcc_except_table*);
        build/src/SB/Game/zUI.o(.gcc_except_table*);
        build/src/SB/Game/zUIFont.o(.gcc_except_table*);
        build/src/SB/Game/zVar.o(.gcc_except_table*);
        build/src/SB/Game/zVolume.o(.gcc_except_table*);
        build/src/SB/Game/zActionLine.o(.gcc_except_table*);
        build/src/SB/Core/p2/iAnimSKB.o(.gcc_except_table*);
        build/src/SB/Core/p2/iCollide.o(.gcc_except_table*);
        build/src/SB/Core/p2/iCollideFast.o(.gcc_except_table*);
        build/src/SB/Core/p2/iDraw.o(.gcc_except_table*);
        build/src/SB/Core/p2/iEnv.o(.gcc_except_table*);
        build/src/SB/Core/p2/iFile.o(.gcc_except_table*);
        build/src/SB/Core/p2/iFMV.o(.gcc_except_table*);
        build/src/SB/Core/p2/iFX.o(.gcc_except_table*);
        build/src/SB/Core/p2/iLight.o(.gcc_except_table*);
        build/src/SB/Core/p2/iMath3.o(.gcc_except_table*);
        build/src/SB/Core/p2/iMemMgr.o(.gcc_except_table*);
        build/src/SB/Core/p2/iModel.o(.gcc_except_table*);
        build/src/SB/Core/p2/iMorph.o(.gcc_except_table*);
        build/src/SB/Core/p2/iPad.o(.gcc_except_table*);
        build/src/SB/Core/p2/iParMgr.o(.gcc_except_table*);
        build/src/SB/Core/p2/isavegame.o(.gcc_except_table*);
        build/src/SB/Core/p2/iScrFX.o(.gcc_except_table*);
        build/src/SB/Core/p2/iSnd.o(.gcc_except_table*);
        build/src/SB/Core/p2/iSystem.o(.gcc_except_table*);
        build/src/SB/Core/p2/iTime.o(.gcc_except_table*);
        build/src/SB/Core/p2/p2im3dhack.o(.gcc_except_table*);
        build/src/SB/Core/p2/iAnim.o(.gcc_except_table*);
        build/src/SB/Core/p2/ps2_mpeg/audiodec.o(.gcc_except_table*);
        build/src/SB/Core/p2/ps2_mpeg/disp.o(.gcc_except_table*);
        build/src/SB/Core/p2/ps2_mpeg/ps2_mpeg.o(.gcc_except_table*);
        build/src/SB/Core/p2/ps2_mpeg/read.o(.gcc_except_table*);
        build/src/SB/Core/p2/ps2_mpeg/readbuf.o(.gcc_except_table*);
        build/src/SB/Core/p2/ps2_mpeg/strfile.o(.gcc_except_table*);
        build/src/SB/Core/p2/ps2_mpeg/vibuf.o(.gcc_except_table*);
        build/src/SB/Core/p2/ps2_mpeg/videodec.o(.gcc_except_table*);
        build/src/SB/Core/p2/ps2_mpeg/vobuf.o(.gcc_except_table*);
        build/src/SB/Core/x/xBase.o(.gcc_except_table*);
        build/src/SB/Core/x/xbinio.o(.gcc_except_table*);
        build/src/SB/Core/x/xBound.o(.gcc_except_table*);
        build/src/SB/Core/x/xCamera.o(.gcc_except_table*);
        build/src/SB/Core/x/xClimate.o(.gcc_except_table*);
        build/src/SB/Core/x/xCollide.o(.gcc_except_table*);
        build/src/SB/Core/x/xCollideFast.o(.gcc_except_table*);
        build/src/SB/Core/x/xCutscene.o(.gcc_except_table*);
        build/src/SB/Core/x/xDebug.o(.gcc_except_table*);
        build/src/SB/Core/x/xEnt.o(.gcc_except_table*);
        build/src/SB/Core/x/xEntDrive.o(.gcc_except_table*);
        build/src/SB/Core/x/xEntMotion.o(.gcc_except_table*);
        build/src/SB/Core/x/xEnv.o(.gcc_except_table*);
        build/src/SB/Core/x/xFFX.o(.gcc_except_table*);
        build/src/SB/Core/x/xFont.o(.gcc_except_table*);
        build/src/SB/Core/x/xFX.o(.gcc_except_table*);
        build/src/SB/Core/x/xhipio.o(.gcc_except_table*);
        build/src/SB/Core/x/xIni.o(.gcc_except_table*);
        build/src/SB/Core/x/xMath.o(.gcc_except_table*);
        build/src/SB/Core/x/xMath3.o(.gcc_except_table*);
        build/src/SB/Core/x/xMemMgr.o(.gcc_except_table*);
        build/src/SB/Core/x/xModel.o(.gcc_except_table*);
        build/src/SB/Core/x/xMorph.o(.gcc_except_table*);
        build/src/SB/Core/x/xMovePoint.o(.gcc_except_table*);
        build/src/SB/Core/x/xordarray.o(.gcc_except_table*);
        build/src/SB/Core/x/xPad.o(.gcc_except_table*);
        build/src/SB/Core/x/xPar.o(.gcc_except_table*);
        build/src/SB/Core/x/xParCmd.o(.gcc_except_table*);
        build/src/SB/Core/x/xParGroup.o(.gcc_except_table*);
        build/src/SB/Core/x/xParMgr.o(.gcc_except_table*);
        build/src/SB/Core/x/xPartition.o(.gcc_except_table*);
        build/src/SB/Core/x/xpkrsvc.o(.gcc_except_table*);
        build/src/SB/Core/x/xQuickCull.o(.gcc_except_table*);
        build/src/SB/Core/x/xsavegame.o(.gcc_except_table*);
        build/src/SB/Core/x/xScene.o(.gcc_except_table*);
        build/src/SB/Core/x/xScrFx.o(.gcc_except_table*);
        build/src/SB/Core/x/xserializer.o(.gcc_except_table*);
        build/src/SB/Core/x/xShadow.o(.gcc_except_table*);
        build/src/SB/Core/x/xSnd.o(.gcc_except_table*);
        build/src/SB/Core/x/xSpline.o(.gcc_except_table*);
        build/src/SB/Core/x/xstransvc.o(.gcc_except_table*);
        build/src/SB/Core/x/xString.o(.gcc_except_table*);
        build/src/SB/Core/x/xSurface.o(.gcc_except_table*);
        build/src/SB/Core/x/xTRC.o(.gcc_except_table*);
        build/src/SB/Core/x/xutil.o(.gcc_except_table*);
        build/src/SB/Core/x/xVec3.o(.gcc_except_table*);
        build/src/SB/Core/x/xAnim.o(.gcc_except_table*);
        build/src/SB/Game/zThrown.o(.gcc_except_table*);
        build/src/SB/Core/x/xEvent.o(.gcc_except_table*);
        build/src/SB/Core/x/xHud.o(.gcc_except_table*);
        build/src/SB/Core/x/xHudFontMeter.o(.gcc_except_table*);
        build/src/SB/Core/x/xHudMeter.o(.gcc_except_table*);
        build/src/SB/Core/x/xHudModel.o(.gcc_except_table*);
        build/src/SB/Core/x/xHudUnitMeter.o(.gcc_except_table*);
        build/src/SB/Game/zLasso.o(.gcc_except_table*);
        build/src/SB/Game/zPickupTable.o(.gcc_except_table*);
        build/src/SB/Core/x/xCounter.o(.gcc_except_table*);
        build/src/SB/Core/x/xTimer.o(.gcc_except_table*);
        build/src/SB/Core/x/xFog.o(.gcc_except_table*);
        build/src/SB/Core/x/xSFX.o(.gcc_except_table*);
        build/src/SB/Core/x/xGroup.o(.gcc_except_table*);
        build/src/SB/Game/zEntCruiseBubble.o(.gcc_except_table*);
        build/src/SB/Core/x/xSkyDome.o(.gcc_except_table*);
        build/src/SB/Game/zNPCGoalRobo.o(.gcc_except_table*);
        build/src/SB/Core/x/xListItem.o(.gcc_except_table*);
        build/src/SB/Game/zNPCGoals.o(.gcc_except_table*);
        build/src/SB/Game/zNPCGoalStd.o(.gcc_except_table*);
        build/src/SB/Game/zNPCGoalTiki.o(.gcc_except_table*);
        build/src/SB/Game/zNPCGoalCommon.o(.gcc_except_table*);
        build/src/SB/Game/zNPCMessenger.o(.gcc_except_table*);
        build/src/SB/Game/zNPCMgr.o(.gcc_except_table*);
        build/src/SB/Game/zNPCTypeAmbient.o(.gcc_except_table*);
        build/src/SB/Game/zNPCTypeCommon.o(.gcc_except_table*);
        build/src/SB/Game/zNPCTypeRobot.o(.gcc_except_table*);
        build/src/SB/Game/zNPCTypes.o(.gcc_except_table*);
        build/src/SB/Game/zNPCTypeTiki.o(.gcc_except_table*);
        build/src/SB/Game/zNPCTypeVillager.o(.gcc_except_table*);
        build/src/SB/Core/x/xBehaveMgr.o(.gcc_except_table*);
        build/src/SB/Core/x/xBehaviour.o(.gcc_except_table*);
        build/src/SB/Core/x/xFactory.o(.gcc_except_table*);
        build/src/SB/Core/x/xNPCBasic.o(.gcc_except_table*);
        build/src/SB/Core/x/xRMemData.o(.gcc_except_table*);
        build/src/SB/Core/x/xBehaveGoalSimple.o(.gcc_except_table*);
        build/src/SB/Game/zCollGeom.o(.gcc_except_table*);
        build/src/SB/Game/zEntPlayerBungeeState.o(.gcc_except_table*);
        build/src/SB/Core/x/xParSys.o(.gcc_except_table*);
        build/src/SB/Core/x/xParEmitter.o(.gcc_except_table*);
        build/src/SB/Core/x/xVolume.o(.gcc_except_table*);
        build/src/SB/Core/x/xParEmitterType.o(.gcc_except_table*);
        build/src/SB/Core/x/xRenderState.o(.gcc_except_table*);
        build/src/SB/Core/x/xJSP.o(.gcc_except_table*);
        build/src/SB/Core/x/xClumpColl.o(.gcc_except_table*);
        build/src/SB/Core/x/xGrid.o(.gcc_except_table*);
        build/src/SB/Core/x/xLightKit.o(.gcc_except_table*);
        build/src/SB/Game/zGrid.o(.gcc_except_table*);
        build/src/SB/Core/x/xEntBoulder.o(.gcc_except_table*);
        build/src/SB/Game/zEntPlayerOOBState.o(.gcc_except_table*);
        build/src/SB/Game/zNPCTypeDuplotron.o(.gcc_except_table*);
        build/src/SB/Game/zGoo.o(.gcc_except_table*);
        build/src/SB/Game/zNPCGoalScript.o(.gcc_except_table*);
        build/src/SB/Game/zNPCSndTable.o(.gcc_except_table*);
        build/src/SB/Game/zCamMarker.o(.gcc_except_table*);
        build/src/SB/Core/x/xModelBucket.o(.gcc_except_table*);
        build/src/SB/Game/zShrapnel.o(.gcc_except_table*);
        build/src/SB/Game/zNPCSpawner.o(.gcc_except_table*);
        build/src/SB/Game/zEntTeleportBox.o(.gcc_except_table*);
        build/src/SB/Game/zNPCGoalDuplotron.o(.gcc_except_table*);
        build/src/SB/Game/zBusStop.o(.gcc_except_table*);
        build/src/SB/Game/zNPCSupport.o(.gcc_except_table*);
        build/src/SB/Game/zTalkBox.o(.gcc_except_table*);
        build/src/SB/Game/zTextBox.o(.gcc_except_table*);
        build/src/SB/Game/zTaskBox.o(.gcc_except_table*);
        build/src/SB/Game/zNPCTypeTest.o(.gcc_except_table*);
        build/src/SB/Game/zNPCGoalSubBoss.o(.gcc_except_table*);
        build/src/SB/Game/zNPCTypeBoss.o(.gcc_except_table*);
        build/src/SB/Game/zNPCGoalBoss.o(.gcc_except_table*);
        build/src/SB/Game/zNPCTypeSubBoss.o(.gcc_except_table*);
        build/src/SB/Game/zNPCGoalVillager.o(.gcc_except_table*);
        build/src/SB/Core/x/xUpdateCull.o(.gcc_except_table*);
        build/src/SB/Core/p2/iFXGoo.o(.gcc_except_table*);
        build/src/SB/Core/x/xShadowSimple.o(.gcc_except_table*);
        build/src/SB/Game/zNPCTypeBossSandy.o(.gcc_except_table*);
        build/src/SB/Game/zDiscoFloor.o(.gcc_except_table*);
        build/src/SB/Core/p2/iFXshadow.o(.gcc_except_table*);
        build/src/SB/Game/zNPCTypeKingJelly.o(.gcc_except_table*);
        build/src/SB/Core/p2/his/HisStubs.o(.gcc_except_table*);
        build/src/SB/Core/p2/his/HISAPI.o(.gcc_except_table*);
        build/src/SB/Core/p2/iCutscene.o(.gcc_except_table*);
        build/src/SB/Game/zNPCTypeBossSB2.o(.gcc_except_table*);
        build/src/SB/Game/zNPCTypeBossSB1.o(.gcc_except_table*);
        build/src/SB/Core/x/iCamera.o(.gcc_except_table*);
        build/src/SB/Core/x/xJaw.o(.gcc_except_table*);
        build/src/SB/Game/zNPCTypePrawn.o(.gcc_except_table*);
        build/src/SB/Game/zNPCTypeBossPlankton.o(.gcc_except_table*);
        build/src/SB/Game/zNPCTypeBossPatrick.o(.gcc_except_table*);
        build/src/SB/Core/p2/iVU0.o(.gcc_except_table*);
        build/src/SB/Game/zParPTank.o(.gcc_except_table*);
        build/src/SB/Game/zTaxi.o(.gcc_except_table*);
        build/src/SB/Game/zNPCTypeDutchman.o(.gcc_except_table*);
        build/src/SB/Game/zCameraFly.o(.gcc_except_table*);
        build/src/SB/Core/x/xCurveAsset.o(.gcc_except_table*);
        build/src/SB/Core/p2/iModelBucketPDS.o(.gcc_except_table*);
        build/src/SB/Core/x/xDecal.o(.gcc_except_table*);
        build/src/SB/Core/x/xPtankPool.o(.gcc_except_table*);
        build/src/SB/Core/x/xLaserBolt.o(.gcc_except_table*);
        build/src/SB/Game/zCameraTweak.o(.gcc_except_table*);
        build/src/SB/Game/zNPCSupplement.o(.gcc_except_table*);
        build/src/SB/Game/zNPCGoalAmbient.o(.gcc_except_table*);
        build/src/SB/Game/zNPCHazard.o(.gcc_except_table*);
        build/src/SB/Game/zNPCGlyph.o(.gcc_except_table*);
        build/src/SB/Game/zNPCFXCinematic.o(.gcc_except_table*);
        build/src/SB/Game/zCombo.o(.gcc_except_table*);
        build/src/SB/Core/x/xHudText.o(.gcc_except_table*);
        build/src/SB/Core/x/xCM.o(.gcc_except_table*);
        build/src/SB/Core/p2/iException.o(.gcc_except_table*);
        build/asm/data/cod/3209C0.o(.gcc_except_table*);
        build/asm/data/cod/3B0780.gcc_except_table.o(.gcc_except_table*);
        . = ALIGN(., 16);
        cod_GCC_EXCEPT_TABLE_END = .;
        cod_GCC_EXCEPT_TABLE_SIZE = ABSOLUTE(cod_GCC_EXCEPT_TABLE_END - cod_GCC_EXCEPT_TABLE_START);
    }
    cod_bss_VRAM = ADDR(.cod_bss);
    .cod_bss (NOLOAD) :
    {
        FILL(0x00000000);
        cod_SBSS_START = .;
        build/asm/cod/000000.o(.sbss COMMON .scommon);
        build/src/SB/Game/zAnimList.o(.sbss COMMON .scommon);
        build/src/SB/Game/zAssetTypes.o(.sbss COMMON .scommon);
        build/src/SB/Game/zCamera.o(.sbss COMMON .scommon);
        build/src/SB/Game/zConditional.o(.sbss COMMON .scommon);
        build/src/SB/Game/zCutsceneMgr.o(.sbss COMMON .scommon);
        build/src/SB/Game/zDispatcher.o(.sbss COMMON .scommon);
        build/src/SB/Game/zEGenerator.o(.sbss COMMON .scommon);
        build/src/SB/Game/zEnt.o(.sbss COMMON .scommon);
        build/src/SB/Game/zEntButton.o(.sbss COMMON .scommon);
        build/src/SB/Game/zEntDestructObj.o(.sbss COMMON .scommon);
        build/src/SB/Game/zEntHangable.o(.sbss COMMON .scommon);
        build/src/SB/Game/zEntPickup.o(.sbss COMMON .scommon);
        build/src/SB/Game/zEntPlayer.o(.sbss COMMON .scommon);
        build/src/SB/Game/zEntSimpleObj.o(.sbss COMMON .scommon);
        build/src/SB/Game/zEntTrigger.o(.sbss COMMON .scommon);
        build/src/SB/Game/zEnv.o(.sbss COMMON .scommon);
        build/src/SB/Game/zEvent.o(.sbss COMMON .scommon);
        build/src/SB/Game/zFeet.o(.sbss COMMON .scommon);
        build/src/SB/Game/zFMV.o(.sbss COMMON .scommon);
        build/src/SB/Game/zFX.o(.sbss COMMON .scommon);
        build/src/SB/Game/zGame.o(.sbss COMMON .scommon);
        build/src/SB/Game/zGameExtras.o(.sbss COMMON .scommon);
        build/src/SB/Game/zGameState.o(.sbss COMMON .scommon);
        build/src/SB/Game/zGust.o(.sbss COMMON .scommon);
        build/src/SB/Game/zHud.o(.sbss COMMON .scommon);
        build/src/SB/Game/zLight.o(.sbss COMMON .scommon);
        build/src/SB/Game/zLightEffect.o(.sbss COMMON .scommon);
        build/src/SB/Game/zLightning.o(.sbss COMMON .scommon);
        build/src/SB/Game/zLOD.o(.sbss COMMON .scommon);
        build/src/SB/Game/zMain.o(.sbss COMMON .scommon);
        build/src/SB/Game/zMenu.o(.sbss COMMON .scommon);
        build/src/SB/Game/zMovePoint.o(.sbss COMMON .scommon);
        build/src/SB/Game/zMusic.o(.sbss COMMON .scommon);
        build/src/SB/Game/zParCmd.o(.sbss COMMON .scommon);
        build/src/SB/Game/zParEmitter.o(.sbss COMMON .scommon);
        build/src/SB/Game/zPendulum.o(.sbss COMMON .scommon);
        build/src/SB/Game/zPlatform.o(.sbss COMMON .scommon);
        build/src/SB/Game/zPortal.o(.sbss COMMON .scommon);
        build/src/SB/Game/zRenderState.o(.sbss COMMON .scommon);
        build/src/SB/Game/zRumble.o(.sbss COMMON .scommon);
        build/src/SB/Game/zSaveLoad.o(.sbss COMMON .scommon);
        build/src/SB/Game/zScene.o(.sbss COMMON .scommon);
        build/src/SB/Game/zScript.o(.sbss COMMON .scommon);
        build/src/SB/Game/zSurface.o(.sbss COMMON .scommon);
        build/src/SB/Game/zUI.o(.sbss COMMON .scommon);
        build/src/SB/Game/zUIFont.o(.sbss COMMON .scommon);
        build/src/SB/Game/zVar.o(.sbss COMMON .scommon);
        build/src/SB/Game/zVolume.o(.sbss COMMON .scommon);
        build/src/SB/Game/zActionLine.o(.sbss COMMON .scommon);
        build/src/SB/Core/p2/iAnimSKB.o(.sbss COMMON .scommon);
        build/src/SB/Core/p2/iCollide.o(.sbss COMMON .scommon);
        build/src/SB/Core/p2/iCollideFast.o(.sbss COMMON .scommon);
        build/src/SB/Core/p2/iDraw.o(.sbss COMMON .scommon);
        build/src/SB/Core/p2/iEnv.o(.sbss COMMON .scommon);
        build/src/SB/Core/p2/iFile.o(.sbss COMMON .scommon);
        build/src/SB/Core/p2/iFMV.o(.sbss COMMON .scommon);
        build/src/SB/Core/p2/iFX.o(.sbss COMMON .scommon);
        build/src/SB/Core/p2/iLight.o(.sbss COMMON .scommon);
        build/src/SB/Core/p2/iMath3.o(.sbss COMMON .scommon);
        build/src/SB/Core/p2/iMemMgr.o(.sbss COMMON .scommon);
        build/src/SB/Core/p2/iModel.o(.sbss COMMON .scommon);
        build/src/SB/Core/p2/iMorph.o(.sbss COMMON .scommon);
        build/src/SB/Core/p2/iPad.o(.sbss COMMON .scommon);
        build/src/SB/Core/p2/iParMgr.o(.sbss COMMON .scommon);
        build/src/SB/Core/p2/isavegame.o(.sbss COMMON .scommon);
        build/src/SB/Core/p2/iScrFX.o(.sbss COMMON .scommon);
        build/src/SB/Core/p2/iSnd.o(.sbss COMMON .scommon);
        build/src/SB/Core/p2/iSystem.o(.sbss COMMON .scommon);
        build/src/SB/Core/p2/iTime.o(.sbss COMMON .scommon);
        build/src/SB/Core/p2/p2im3dhack.o(.sbss COMMON .scommon);
        build/src/SB/Core/p2/iAnim.o(.sbss COMMON .scommon);
        build/src/SB/Core/p2/ps2_mpeg/audiodec.o(.sbss COMMON .scommon);
        build/src/SB/Core/p2/ps2_mpeg/disp.o(.sbss COMMON .scommon);
        build/src/SB/Core/p2/ps2_mpeg/ps2_mpeg.o(.sbss COMMON .scommon);
        build/src/SB/Core/p2/ps2_mpeg/read.o(.sbss COMMON .scommon);
        build/src/SB/Core/p2/ps2_mpeg/readbuf.o(.sbss COMMON .scommon);
        build/src/SB/Core/p2/ps2_mpeg/strfile.o(.sbss COMMON .scommon);
        build/src/SB/Core/p2/ps2_mpeg/vibuf.o(.sbss COMMON .scommon);
        build/src/SB/Core/p2/ps2_mpeg/videodec.o(.sbss COMMON .scommon);
        build/src/SB/Core/p2/ps2_mpeg/vobuf.o(.sbss COMMON .scommon);
        build/src/SB/Core/x/xBase.o(.sbss COMMON .scommon);
        build/src/SB/Core/x/xbinio.o(.sbss COMMON .scommon);
        build/src/SB/Core/x/xBound.o(.sbss COMMON .scommon);
        build/src/SB/Core/x/xCamera.o(.sbss COMMON .scommon);
        build/src/SB/Core/x/xClimate.o(.sbss COMMON .scommon);
        build/src/SB/Core/x/xCollide.o(.sbss COMMON .scommon);
        build/src/SB/Core/x/xCollideFast.o(.sbss COMMON .scommon);
        build/src/SB/Core/x/xCutscene.o(.sbss COMMON .scommon);
        build/src/SB/Core/x/xDebug.o(.sbss COMMON .scommon);
        build/src/SB/Core/x/xEnt.o(.sbss COMMON .scommon);
        build/src/SB/Core/x/xEntDrive.o(.sbss COMMON .scommon);
        build/src/SB/Core/x/xEntMotion.o(.sbss COMMON .scommon);
        build/src/SB/Core/x/xEnv.o(.sbss COMMON .scommon);
        build/src/SB/Core/x/xFFX.o(.sbss COMMON .scommon);
        build/src/SB/Core/x/xFont.o(.sbss COMMON .scommon);
        build/src/SB/Core/x/xFX.o(.sbss COMMON .scommon);
        build/src/SB/Core/x/xhipio.o(.sbss COMMON .scommon);
        build/src/SB/Core/x/xIni.o(.sbss COMMON .scommon);
        build/src/SB/Core/x/xMath.o(.sbss COMMON .scommon);
        build/src/SB/Core/x/xMath3.o(.sbss COMMON .scommon);
        build/src/SB/Core/x/xMemMgr.o(.sbss COMMON .scommon);
        build/src/SB/Core/x/xModel.o(.sbss COMMON .scommon);
        build/src/SB/Core/x/xMorph.o(.sbss COMMON .scommon);
        build/src/SB/Core/x/xMovePoint.o(.sbss COMMON .scommon);
        build/src/SB/Core/x/xordarray.o(.sbss COMMON .scommon);
        build/src/SB/Core/x/xPad.o(.sbss COMMON .scommon);
        build/src/SB/Core/x/xPar.o(.sbss COMMON .scommon);
        build/src/SB/Core/x/xParCmd.o(.sbss COMMON .scommon);
        build/src/SB/Core/x/xParGroup.o(.sbss COMMON .scommon);
        build/src/SB/Core/x/xParMgr.o(.sbss COMMON .scommon);
        build/src/SB/Core/x/xPartition.o(.sbss COMMON .scommon);
        build/src/SB/Core/x/xpkrsvc.o(.sbss COMMON .scommon);
        build/src/SB/Core/x/xQuickCull.o(.sbss COMMON .scommon);
        build/src/SB/Core/x/xsavegame.o(.sbss COMMON .scommon);
        build/src/SB/Core/x/xScene.o(.sbss COMMON .scommon);
        build/src/SB/Core/x/xScrFx.o(.sbss COMMON .scommon);
        build/src/SB/Core/x/xserializer.o(.sbss COMMON .scommon);
        build/src/SB/Core/x/xShadow.o(.sbss COMMON .scommon);
        build/src/SB/Core/x/xSnd.o(.sbss COMMON .scommon);
        build/src/SB/Core/x/xSpline.o(.sbss COMMON .scommon);
        build/src/SB/Core/x/xstransvc.o(.sbss COMMON .scommon);
        build/src/SB/Core/x/xString.o(.sbss COMMON .scommon);
        build/src/SB/Core/x/xSurface.o(.sbss COMMON .scommon);
        build/src/SB/Core/x/xTRC.o(.sbss COMMON .scommon);
        build/src/SB/Core/x/xutil.o(.sbss COMMON .scommon);
        build/src/SB/Core/x/xVec3.o(.sbss COMMON .scommon);
        build/src/SB/Core/x/xAnim.o(.sbss COMMON .scommon);
        build/src/SB/Game/zThrown.o(.sbss COMMON .scommon);
        build/src/SB/Core/x/xEvent.o(.sbss COMMON .scommon);
        build/src/SB/Core/x/xHud.o(.sbss COMMON .scommon);
        build/src/SB/Core/x/xHudFontMeter.o(.sbss COMMON .scommon);
        build/src/SB/Core/x/xHudMeter.o(.sbss COMMON .scommon);
        build/src/SB/Core/x/xHudModel.o(.sbss COMMON .scommon);
        build/src/SB/Core/x/xHudUnitMeter.o(.sbss COMMON .scommon);
        build/src/SB/Game/zLasso.o(.sbss COMMON .scommon);
        build/src/SB/Game/zPickupTable.o(.sbss COMMON .scommon);
        build/src/SB/Core/x/xCounter.o(.sbss COMMON .scommon);
        build/src/SB/Core/x/xTimer.o(.sbss COMMON .scommon);
        build/src/SB/Core/x/xFog.o(.sbss COMMON .scommon);
        build/src/SB/Core/x/xSFX.o(.sbss COMMON .scommon);
        build/src/SB/Core/x/xGroup.o(.sbss COMMON .scommon);
        build/src/SB/Game/zEntCruiseBubble.o(.sbss COMMON .scommon);
        build/src/SB/Core/x/xSkyDome.o(.sbss COMMON .scommon);
        build/src/SB/Game/zNPCGoalRobo.o(.sbss COMMON .scommon);
        build/src/SB/Core/x/xListItem.o(.sbss COMMON .scommon);
        build/src/SB/Game/zNPCGoals.o(.sbss COMMON .scommon);
        build/src/SB/Game/zNPCGoalStd.o(.sbss COMMON .scommon);
        build/src/SB/Game/zNPCGoalTiki.o(.sbss COMMON .scommon);
        build/src/SB/Game/zNPCGoalCommon.o(.sbss COMMON .scommon);
        build/src/SB/Game/zNPCMessenger.o(.sbss COMMON .scommon);
        build/src/SB/Game/zNPCMgr.o(.sbss COMMON .scommon);
        build/src/SB/Game/zNPCTypeAmbient.o(.sbss COMMON .scommon);
        build/src/SB/Game/zNPCTypeCommon.o(.sbss COMMON .scommon);
        build/src/SB/Game/zNPCTypeRobot.o(.sbss COMMON .scommon);
        build/src/SB/Game/zNPCTypes.o(.sbss COMMON .scommon);
        build/src/SB/Game/zNPCTypeTiki.o(.sbss COMMON .scommon);
        build/src/SB/Game/zNPCTypeVillager.o(.sbss COMMON .scommon);
        build/src/SB/Core/x/xBehaveMgr.o(.sbss COMMON .scommon);
        build/src/SB/Core/x/xBehaviour.o(.sbss COMMON .scommon);
        build/src/SB/Core/x/xFactory.o(.sbss COMMON .scommon);
        build/src/SB/Core/x/xNPCBasic.o(.sbss COMMON .scommon);
        build/src/SB/Core/x/xRMemData.o(.sbss COMMON .scommon);
        build/src/SB/Core/x/xBehaveGoalSimple.o(.sbss COMMON .scommon);
        build/src/SB/Game/zCollGeom.o(.sbss COMMON .scommon);
        build/src/SB/Game/zEntPlayerBungeeState.o(.sbss COMMON .scommon);
        build/src/SB/Core/x/xParSys.o(.sbss COMMON .scommon);
        build/src/SB/Core/x/xParEmitter.o(.sbss COMMON .scommon);
        build/src/SB/Core/x/xVolume.o(.sbss COMMON .scommon);
        build/src/SB/Core/x/xParEmitterType.o(.sbss COMMON .scommon);
        build/src/SB/Core/x/xRenderState.o(.sbss COMMON .scommon);
        build/src/SB/Core/x/xJSP.o(.sbss COMMON .scommon);
        build/src/SB/Core/x/xClumpColl.o(.sbss COMMON .scommon);
        build/src/SB/Core/x/xGrid.o(.sbss COMMON .scommon);
        build/src/SB/Core/x/xLightKit.o(.sbss COMMON .scommon);
        build/src/SB/Game/zGrid.o(.sbss COMMON .scommon);
        build/src/SB/Core/x/xEntBoulder.o(.sbss COMMON .scommon);
        build/src/SB/Game/zEntPlayerOOBState.o(.sbss COMMON .scommon);
        build/src/SB/Game/zNPCTypeDuplotron.o(.sbss COMMON .scommon);
        build/src/SB/Game/zGoo.o(.sbss COMMON .scommon);
        build/src/SB/Game/zNPCGoalScript.o(.sbss COMMON .scommon);
        build/src/SB/Game/zNPCSndTable.o(.sbss COMMON .scommon);
        build/src/SB/Game/zCamMarker.o(.sbss COMMON .scommon);
        build/src/SB/Core/x/xModelBucket.o(.sbss COMMON .scommon);
        build/src/SB/Game/zShrapnel.o(.sbss COMMON .scommon);
        build/src/SB/Game/zNPCSpawner.o(.sbss COMMON .scommon);
        build/src/SB/Game/zEntTeleportBox.o(.sbss COMMON .scommon);
        build/src/SB/Game/zNPCGoalDuplotron.o(.sbss COMMON .scommon);
        build/src/SB/Game/zBusStop.o(.sbss COMMON .scommon);
        build/src/SB/Game/zNPCSupport.o(.sbss COMMON .scommon);
        build/src/SB/Game/zTalkBox.o(.sbss COMMON .scommon);
        build/src/SB/Game/zTextBox.o(.sbss COMMON .scommon);
        build/src/SB/Game/zTaskBox.o(.sbss COMMON .scommon);
        build/src/SB/Game/zNPCTypeTest.o(.sbss COMMON .scommon);
        build/src/SB/Game/zNPCGoalSubBoss.o(.sbss COMMON .scommon);
        build/src/SB/Game/zNPCTypeBoss.o(.sbss COMMON .scommon);
        build/src/SB/Game/zNPCGoalBoss.o(.sbss COMMON .scommon);
        build/src/SB/Game/zNPCTypeSubBoss.o(.sbss COMMON .scommon);
        build/src/SB/Game/zNPCGoalVillager.o(.sbss COMMON .scommon);
        build/src/SB/Core/x/xUpdateCull.o(.sbss COMMON .scommon);
        build/src/SB/Core/p2/iFXGoo.o(.sbss COMMON .scommon);
        build/src/SB/Core/x/xShadowSimple.o(.sbss COMMON .scommon);
        build/src/SB/Game/zNPCTypeBossSandy.o(.sbss COMMON .scommon);
        build/src/SB/Game/zDiscoFloor.o(.sbss COMMON .scommon);
        build/src/SB/Core/p2/iFXshadow.o(.sbss COMMON .scommon);
        build/src/SB/Game/zNPCTypeKingJelly.o(.sbss COMMON .scommon);
        build/src/SB/Core/p2/his/HisStubs.o(.sbss COMMON .scommon);
        build/src/SB/Core/p2/his/HISAPI.o(.sbss COMMON .scommon);
        build/src/SB/Core/p2/iCutscene.o(.sbss COMMON .scommon);
        build/src/SB/Game/zNPCTypeBossSB2.o(.sbss COMMON .scommon);
        build/src/SB/Game/zNPCTypeBossSB1.o(.sbss COMMON .scommon);
        build/src/SB/Core/x/iCamera.o(.sbss COMMON .scommon);
        build/src/SB/Core/x/xJaw.o(.sbss COMMON .scommon);
        build/src/SB/Game/zNPCTypePrawn.o(.sbss COMMON .scommon);
        build/src/SB/Game/zNPCTypeBossPlankton.o(.sbss COMMON .scommon);
        build/src/SB/Game/zNPCTypeBossPatrick.o(.sbss COMMON .scommon);
        build/src/SB/Core/p2/iVU0.o(.sbss COMMON .scommon);
        build/src/SB/Game/zParPTank.o(.sbss COMMON .scommon);
        build/src/SB/Game/zTaxi.o(.sbss COMMON .scommon);
        build/src/SB/Game/zNPCTypeDutchman.o(.sbss COMMON .scommon);
        build/src/SB/Game/zCameraFly.o(.sbss COMMON .scommon);
        build/src/SB/Core/x/xCurveAsset.o(.sbss COMMON .scommon);
        build/src/SB/Core/p2/iModelBucketPDS.o(.sbss COMMON .scommon);
        build/src/SB/Core/x/xDecal.o(.sbss COMMON .scommon);
        build/src/SB/Core/x/xPtankPool.o(.sbss COMMON .scommon);
        build/src/SB/Core/x/xLaserBolt.o(.sbss COMMON .scommon);
        build/src/SB/Game/zCameraTweak.o(.sbss COMMON .scommon);
        build/src/SB/Game/zNPCSupplement.o(.sbss COMMON .scommon);
        build/src/SB/Game/zNPCGoalAmbient.o(.sbss COMMON .scommon);
        build/src/SB/Game/zNPCHazard.o(.sbss COMMON .scommon);
        build/src/SB/Game/zNPCGlyph.o(.sbss COMMON .scommon);
        build/src/SB/Game/zNPCFXCinematic.o(.sbss COMMON .scommon);
        build/src/SB/Game/zCombo.o(.sbss COMMON .scommon);
        build/src/SB/Core/x/xHudText.o(.sbss COMMON .scommon);
        build/src/SB/Core/x/xCM.o(.sbss COMMON .scommon);
        build/src/SB/Core/p2/iException.o(.sbss COMMON .scommon);
        build/asm/data/cod/3209C0.o(.sbss COMMON .scommon);
        build/asm/data/cod/004B0880.sbss.o(.sbss COMMON .scommon);
        . = ALIGN(., 16);
        cod_SBSS_END = .;
        cod_SBSS_SIZE = ABSOLUTE(cod_SBSS_END - cod_SBSS_START);
        cod_BSS_START = .;
        build/asm/cod/000000.o(.bss COMMON .scommon);
        build/src/SB/Game/zAnimList.o(.bss COMMON .scommon);
        build/src/SB/Game/zAssetTypes.o(.bss COMMON .scommon);
        build/src/SB/Game/zCamera.o(.bss COMMON .scommon);
        build/src/SB/Game/zConditional.o(.bss COMMON .scommon);
        build/src/SB/Game/zCutsceneMgr.o(.bss COMMON .scommon);
        build/src/SB/Game/zDispatcher.o(.bss COMMON .scommon);
        build/src/SB/Game/zEGenerator.o(.bss COMMON .scommon);
        build/src/SB/Game/zEnt.o(.bss COMMON .scommon);
        build/src/SB/Game/zEntButton.o(.bss COMMON .scommon);
        build/src/SB/Game/zEntDestructObj.o(.bss COMMON .scommon);
        build/src/SB/Game/zEntHangable.o(.bss COMMON .scommon);
        build/src/SB/Game/zEntPickup.o(.bss COMMON .scommon);
        build/src/SB/Game/zEntPlayer.o(.bss COMMON .scommon);
        build/src/SB/Game/zEntSimpleObj.o(.bss COMMON .scommon);
        build/src/SB/Game/zEntTrigger.o(.bss COMMON .scommon);
        build/src/SB/Game/zEnv.o(.bss COMMON .scommon);
        build/src/SB/Game/zEvent.o(.bss COMMON .scommon);
        build/src/SB/Game/zFeet.o(.bss COMMON .scommon);
        build/src/SB/Game/zFMV.o(.bss COMMON .scommon);
        build/src/SB/Game/zFX.o(.bss COMMON .scommon);
        build/src/SB/Game/zGame.o(.bss COMMON .scommon);
        build/src/SB/Game/zGameExtras.o(.bss COMMON .scommon);
        build/src/SB/Game/zGameState.o(.bss COMMON .scommon);
        build/src/SB/Game/zGust.o(.bss COMMON .scommon);
        build/src/SB/Game/zHud.o(.bss COMMON .scommon);
        build/src/SB/Game/zLight.o(.bss COMMON .scommon);
        build/src/SB/Game/zLightEffect.o(.bss COMMON .scommon);
        build/src/SB/Game/zLightning.o(.bss COMMON .scommon);
        build/src/SB/Game/zLOD.o(.bss COMMON .scommon);
        build/src/SB/Game/zMain.o(.bss COMMON .scommon);
        build/src/SB/Game/zMenu.o(.bss COMMON .scommon);
        build/src/SB/Game/zMovePoint.o(.bss COMMON .scommon);
        build/src/SB/Game/zMusic.o(.bss COMMON .scommon);
        build/src/SB/Game/zParCmd.o(.bss COMMON .scommon);
        build/src/SB/Game/zParEmitter.o(.bss COMMON .scommon);
        build/src/SB/Game/zPendulum.o(.bss COMMON .scommon);
        build/src/SB/Game/zPlatform.o(.bss COMMON .scommon);
        build/src/SB/Game/zPortal.o(.bss COMMON .scommon);
        build/src/SB/Game/zRenderState.o(.bss COMMON .scommon);
        build/src/SB/Game/zRumble.o(.bss COMMON .scommon);
        build/src/SB/Game/zSaveLoad.o(.bss COMMON .scommon);
        build/src/SB/Game/zScene.o(.bss COMMON .scommon);
        build/src/SB/Game/zScript.o(.bss COMMON .scommon);
        build/src/SB/Game/zSurface.o(.bss COMMON .scommon);
        build/src/SB/Game/zUI.o(.bss COMMON .scommon);
        build/src/SB/Game/zUIFont.o(.bss COMMON .scommon);
        build/src/SB/Game/zVar.o(.bss COMMON .scommon);
        build/src/SB/Game/zVolume.o(.bss COMMON .scommon);
        build/src/SB/Game/zActionLine.o(.bss COMMON .scommon);
        build/src/SB/Core/p2/iAnimSKB.o(.bss COMMON .scommon);
        build/src/SB/Core/p2/iCollide.o(.bss COMMON .scommon);
        build/src/SB/Core/p2/iCollideFast.o(.bss COMMON .scommon);
        build/src/SB/Core/p2/iDraw.o(.bss COMMON .scommon);
        build/src/SB/Core/p2/iEnv.o(.bss COMMON .scommon);
        build/src/SB/Core/p2/iFile.o(.bss COMMON .scommon);
        build/src/SB/Core/p2/iFMV.o(.bss COMMON .scommon);
        build/src/SB/Core/p2/iFX.o(.bss COMMON .scommon);
        build/src/SB/Core/p2/iLight.o(.bss COMMON .scommon);
        build/src/SB/Core/p2/iMath3.o(.bss COMMON .scommon);
        build/src/SB/Core/p2/iMemMgr.o(.bss COMMON .scommon);
        build/src/SB/Core/p2/iModel.o(.bss COMMON .scommon);
        build/src/SB/Core/p2/iMorph.o(.bss COMMON .scommon);
        build/src/SB/Core/p2/iPad.o(.bss COMMON .scommon);
        build/src/SB/Core/p2/iParMgr.o(.bss COMMON .scommon);
        build/src/SB/Core/p2/isavegame.o(.bss COMMON .scommon);
        build/src/SB/Core/p2/iScrFX.o(.bss COMMON .scommon);
        build/src/SB/Core/p2/iSnd.o(.bss COMMON .scommon);
        build/src/SB/Core/p2/iSystem.o(.bss COMMON .scommon);
        build/src/SB/Core/p2/iTime.o(.bss COMMON .scommon);
        build/src/SB/Core/p2/p2im3dhack.o(.bss COMMON .scommon);
        build/src/SB/Core/p2/iAnim.o(.bss COMMON .scommon);
        build/src/SB/Core/p2/ps2_mpeg/audiodec.o(.bss COMMON .scommon);
        build/src/SB/Core/p2/ps2_mpeg/disp.o(.bss COMMON .scommon);
        build/src/SB/Core/p2/ps2_mpeg/ps2_mpeg.o(.bss COMMON .scommon);
        build/src/SB/Core/p2/ps2_mpeg/read.o(.bss COMMON .scommon);
        build/src/SB/Core/p2/ps2_mpeg/readbuf.o(.bss COMMON .scommon);
        build/src/SB/Core/p2/ps2_mpeg/strfile.o(.bss COMMON .scommon);
        build/src/SB/Core/p2/ps2_mpeg/vibuf.o(.bss COMMON .scommon);
        build/src/SB/Core/p2/ps2_mpeg/videodec.o(.bss COMMON .scommon);
        build/src/SB/Core/p2/ps2_mpeg/vobuf.o(.bss COMMON .scommon);
        build/src/SB/Core/x/xBase.o(.bss COMMON .scommon);
        build/src/SB/Core/x/xbinio.o(.bss COMMON .scommon);
        build/src/SB/Core/x/xBound.o(.bss COMMON .scommon);
        build/src/SB/Core/x/xCamera.o(.bss COMMON .scommon);
        build/src/SB/Core/x/xClimate.o(.bss COMMON .scommon);
        build/src/SB/Core/x/xCollide.o(.bss COMMON .scommon);
        build/src/SB/Core/x/xCollideFast.o(.bss COMMON .scommon);
        build/src/SB/Core/x/xCutscene.o(.bss COMMON .scommon);
        build/src/SB/Core/x/xDebug.o(.bss COMMON .scommon);
        build/src/SB/Core/x/xEnt.o(.bss COMMON .scommon);
        build/src/SB/Core/x/xEntDrive.o(.bss COMMON .scommon);
        build/src/SB/Core/x/xEntMotion.o(.bss COMMON .scommon);
        build/src/SB/Core/x/xEnv.o(.bss COMMON .scommon);
        build/src/SB/Core/x/xFFX.o(.bss COMMON .scommon);
        build/src/SB/Core/x/xFont.o(.bss COMMON .scommon);
        build/src/SB/Core/x/xFX.o(.bss COMMON .scommon);
        build/src/SB/Core/x/xhipio.o(.bss COMMON .scommon);
        build/src/SB/Core/x/xIni.o(.bss COMMON .scommon);
        build/src/SB/Core/x/xMath.o(.bss COMMON .scommon);
        build/src/SB/Core/x/xMath3.o(.bss COMMON .scommon);
        build/src/SB/Core/x/xMemMgr.o(.bss COMMON .scommon);
        build/src/SB/Core/x/xModel.o(.bss COMMON .scommon);
        build/src/SB/Core/x/xMorph.o(.bss COMMON .scommon);
        build/src/SB/Core/x/xMovePoint.o(.bss COMMON .scommon);
        build/src/SB/Core/x/xordarray.o(.bss COMMON .scommon);
        build/src/SB/Core/x/xPad.o(.bss COMMON .scommon);
        build/src/SB/Core/x/xPar.o(.bss COMMON .scommon);
        build/src/SB/Core/x/xParCmd.o(.bss COMMON .scommon);
        build/src/SB/Core/x/xParGroup.o(.bss COMMON .scommon);
        build/src/SB/Core/x/xParMgr.o(.bss COMMON .scommon);
        build/src/SB/Core/x/xPartition.o(.bss COMMON .scommon);
        build/src/SB/Core/x/xpkrsvc.o(.bss COMMON .scommon);
        build/src/SB/Core/x/xQuickCull.o(.bss COMMON .scommon);
        build/src/SB/Core/x/xsavegame.o(.bss COMMON .scommon);
        build/src/SB/Core/x/xScene.o(.bss COMMON .scommon);
        build/src/SB/Core/x/xScrFx.o(.bss COMMON .scommon);
        build/src/SB/Core/x/xserializer.o(.bss COMMON .scommon);
        build/src/SB/Core/x/xShadow.o(.bss COMMON .scommon);
        build/src/SB/Core/x/xSnd.o(.bss COMMON .scommon);
        build/src/SB/Core/x/xSpline.o(.bss COMMON .scommon);
        build/src/SB/Core/x/xstransvc.o(.bss COMMON .scommon);
        build/src/SB/Core/x/xString.o(.bss COMMON .scommon);
        build/src/SB/Core/x/xSurface.o(.bss COMMON .scommon);
        build/src/SB/Core/x/xTRC.o(.bss COMMON .scommon);
        build/src/SB/Core/x/xutil.o(.bss COMMON .scommon);
        build/src/SB/Core/x/xVec3.o(.bss COMMON .scommon);
        build/src/SB/Core/x/xAnim.o(.bss COMMON .scommon);
        build/src/SB/Game/zThrown.o(.bss COMMON .scommon);
        build/src/SB/Core/x/xEvent.o(.bss COMMON .scommon);
        build/src/SB/Core/x/xHud.o(.bss COMMON .scommon);
        build/src/SB/Core/x/xHudFontMeter.o(.bss COMMON .scommon);
        build/src/SB/Core/x/xHudMeter.o(.bss COMMON .scommon);
        build/src/SB/Core/x/xHudModel.o(.bss COMMON .scommon);
        build/src/SB/Core/x/xHudUnitMeter.o(.bss COMMON .scommon);
        build/src/SB/Game/zLasso.o(.bss COMMON .scommon);
        build/src/SB/Game/zPickupTable.o(.bss COMMON .scommon);
        build/src/SB/Core/x/xCounter.o(.bss COMMON .scommon);
        build/src/SB/Core/x/xTimer.o(.bss COMMON .scommon);
        build/src/SB/Core/x/xFog.o(.bss COMMON .scommon);
        build/src/SB/Core/x/xSFX.o(.bss COMMON .scommon);
        build/src/SB/Core/x/xGroup.o(.bss COMMON .scommon);
        build/src/SB/Game/zEntCruiseBubble.o(.bss COMMON .scommon);
        build/src/SB/Core/x/xSkyDome.o(.bss COMMON .scommon);
        build/src/SB/Game/zNPCGoalRobo.o(.bss COMMON .scommon);
        build/src/SB/Core/x/xListItem.o(.bss COMMON .scommon);
        build/src/SB/Game/zNPCGoals.o(.bss COMMON .scommon);
        build/src/SB/Game/zNPCGoalStd.o(.bss COMMON .scommon);
        build/src/SB/Game/zNPCGoalTiki.o(.bss COMMON .scommon);
        build/src/SB/Game/zNPCGoalCommon.o(.bss COMMON .scommon);
        build/src/SB/Game/zNPCMessenger.o(.bss COMMON .scommon);
        build/src/SB/Game/zNPCMgr.o(.bss COMMON .scommon);
        build/src/SB/Game/zNPCTypeAmbient.o(.bss COMMON .scommon);
        build/src/SB/Game/zNPCTypeCommon.o(.bss COMMON .scommon);
        build/src/SB/Game/zNPCTypeRobot.o(.bss COMMON .scommon);
        build/src/SB/Game/zNPCTypes.o(.bss COMMON .scommon);
        build/src/SB/Game/zNPCTypeTiki.o(.bss COMMON .scommon);
        build/src/SB/Game/zNPCTypeVillager.o(.bss COMMON .scommon);
        build/src/SB/Core/x/xBehaveMgr.o(.bss COMMON .scommon);
        build/src/SB/Core/x/xBehaviour.o(.bss COMMON .scommon);
        build/src/SB/Core/x/xFactory.o(.bss COMMON .scommon);
        build/src/SB/Core/x/xNPCBasic.o(.bss COMMON .scommon);
        build/src/SB/Core/x/xRMemData.o(.bss COMMON .scommon);
        build/src/SB/Core/x/xBehaveGoalSimple.o(.bss COMMON .scommon);
        build/src/SB/Game/zCollGeom.o(.bss COMMON .scommon);
        build/src/SB/Game/zEntPlayerBungeeState.o(.bss COMMON .scommon);
        build/src/SB/Core/x/xParSys.o(.bss COMMON .scommon);
        build/src/SB/Core/x/xParEmitter.o(.bss COMMON .scommon);
        build/src/SB/Core/x/xVolume.o(.bss COMMON .scommon);
        build/src/SB/Core/x/xParEmitterType.o(.bss COMMON .scommon);
        build/src/SB/Core/x/xRenderState.o(.bss COMMON .scommon);
        build/src/SB/Core/x/xJSP.o(.bss COMMON .scommon);
        build/src/SB/Core/x/xClumpColl.o(.bss COMMON .scommon);
        build/src/SB/Core/x/xGrid.o(.bss COMMON .scommon);
        build/src/SB/Core/x/xLightKit.o(.bss COMMON .scommon);
        build/src/SB/Game/zGrid.o(.bss COMMON .scommon);
        build/src/SB/Core/x/xEntBoulder.o(.bss COMMON .scommon);
        build/src/SB/Game/zEntPlayerOOBState.o(.bss COMMON .scommon);
        build/src/SB/Game/zNPCTypeDuplotron.o(.bss COMMON .scommon);
        build/src/SB/Game/zGoo.o(.bss COMMON .scommon);
        build/src/SB/Game/zNPCGoalScript.o(.bss COMMON .scommon);
        build/src/SB/Game/zNPCSndTable.o(.bss COMMON .scommon);
        build/src/SB/Game/zCamMarker.o(.bss COMMON .scommon);
        build/src/SB/Core/x/xModelBucket.o(.bss COMMON .scommon);
        build/src/SB/Game/zShrapnel.o(.bss COMMON .scommon);
        build/src/SB/Game/zNPCSpawner.o(.bss COMMON .scommon);
        build/src/SB/Game/zEntTeleportBox.o(.bss COMMON .scommon);
        build/src/SB/Game/zNPCGoalDuplotron.o(.bss COMMON .scommon);
        build/src/SB/Game/zBusStop.o(.bss COMMON .scommon);
        build/src/SB/Game/zNPCSupport.o(.bss COMMON .scommon);
        build/src/SB/Game/zTalkBox.o(.bss COMMON .scommon);
        build/src/SB/Game/zTextBox.o(.bss COMMON .scommon);
        build/src/SB/Game/zTaskBox.o(.bss COMMON .scommon);
        build/src/SB/Game/zNPCTypeTest.o(.bss COMMON .scommon);
        build/src/SB/Game/zNPCGoalSubBoss.o(.bss COMMON .scommon);
        build/src/SB/Game/zNPCTypeBoss.o(.bss COMMON .scommon);
        build/src/SB/Game/zNPCGoalBoss.o(.bss COMMON .scommon);
        build/src/SB/Game/zNPCTypeSubBoss.o(.bss COMMON .scommon);
        build/src/SB/Game/zNPCGoalVillager.o(.bss COMMON .scommon);
        build/src/SB/Core/x/xUpdateCull.o(.bss COMMON .scommon);
        build/src/SB/Core/p2/iFXGoo.o(.bss COMMON .scommon);
        build/src/SB/Core/x/xShadowSimple.o(.bss COMMON .scommon);
        build/src/SB/Game/zNPCTypeBossSandy.o(.bss COMMON .scommon);
        build/src/SB/Game/zDiscoFloor.o(.bss COMMON .scommon);
        build/src/SB/Core/p2/iFXshadow.o(.bss COMMON .scommon);
        build/src/SB/Game/zNPCTypeKingJelly.o(.bss COMMON .scommon);
        build/src/SB/Core/p2/his/HisStubs.o(.bss COMMON .scommon);
        build/src/SB/Core/p2/his/HISAPI.o(.bss COMMON .scommon);
        build/src/SB/Core/p2/iCutscene.o(.bss COMMON .scommon);
        build/src/SB/Game/zNPCTypeBossSB2.o(.bss COMMON .scommon);
        build/src/SB/Game/zNPCTypeBossSB1.o(.bss COMMON .scommon);
        build/src/SB/Core/x/iCamera.o(.bss COMMON .scommon);
        build/src/SB/Core/x/xJaw.o(.bss COMMON .scommon);
        build/src/SB/Game/zNPCTypePrawn.o(.bss COMMON .scommon);
        build/src/SB/Game/zNPCTypeBossPlankton.o(.bss COMMON .scommon);
        build/src/SB/Game/zNPCTypeBossPatrick.o(.bss COMMON .scommon);
        build/src/SB/Core/p2/iVU0.o(.bss COMMON .scommon);
        build/src/SB/Game/zParPTank.o(.bss COMMON .scommon);
        build/src/SB/Game/zTaxi.o(.bss COMMON .scommon);
        build/src/SB/Game/zNPCTypeDutchman.o(.bss COMMON .scommon);
        build/src/SB/Game/zCameraFly.o(.bss COMMON .scommon);
        build/src/SB/Core/x/xCurveAsset.o(.bss COMMON .scommon);
        build/src/SB/Core/p2/iModelBucketPDS.o(.bss COMMON .scommon);
        build/src/SB/Core/x/xDecal.o(.bss COMMON .scommon);
        build/src/SB/Core/x/xPtankPool.o(.bss COMMON .scommon);
        build/src/SB/Core/x/xLaserBolt.o(.bss COMMON .scommon);
        build/src/SB/Game/zCameraTweak.o(.bss COMMON .scommon);
        build/src/SB/Game/zNPCSupplement.o(.bss COMMON .scommon);
        build/src/SB/Game/zNPCGoalAmbient.o(.bss COMMON .scommon);
        build/src/SB/Game/zNPCHazard.o(.bss COMMON .scommon);
        build/src/SB/Game/zNPCGlyph.o(.bss COMMON .scommon);
        build/src/SB/Game/zNPCFXCinematic.o(.bss COMMON .scommon);
        build/src/SB/Game/zCombo.o(.bss COMMON .scommon);
        build/src/SB/Core/x/xHudText.o(.bss COMMON .scommon);
        build/src/SB/Core/x/xCM.o(.bss COMMON .scommon);
        build/src/SB/Core/p2/iException.o(.bss COMMON .scommon);
        build/asm/data/cod/3209C0.o(.bss COMMON .scommon);
        build/asm/data/cod/004B0F80.bss.o(.bss COMMON .scommon);
        . = ALIGN(., 16);
        cod_BSS_END = .;
        cod_BSS_SIZE = ABSOLUTE(cod_BSS_END - cod_BSS_START);
    }
    __romPos += SIZEOF(.cod);
    __romPos = ALIGN(__romPos, 16);
    . = ALIGN(., 16);
    cod_ROM_END = __romPos;
    cod_VRAM_END = .;

    /DISCARD/ :
    {
        *(*);
    }
}
